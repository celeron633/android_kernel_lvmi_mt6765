// SPDX-License-Identifier: GPL-2.0-only
/* S17 Pro mini platform configuration; included by s17promini.dtsi. */

/ {
	cpu_dbgapb@0d410000 {
		compatible = "mediatek,hw_dbg";
		num = <0x08>;
		reg = <0x00 0xd410000 0x00 0x1000 0x00 0xd510000 0x00 0x1000 0x00 0xd610000 0x00 0x1000 0x00 0xd710000 0x00 0x1000 0x00 0xd810000 0x00 0x1000 0x00 0xd910000 0x00 0x1000 0x00 0xda10000 0x00 0x1000 0x00 0xdb10000 0x00 0x1000>;
		phandle = <0x6e>;
	};

	atf_logger {
		compatible = "mediatek,atf_logger";
		interrupts = <0x00 0xf7 0x01>;
	};

	amms_control {
		compatible = "mediatek,amms";
		interrupts = <0x00 0x86 0x01>;
	};

	utos {
		compatible = "microtrust,utos";
		interrupts = <0x00 0xf9 0x01 0x00 0xfa 0x01>;
	};

	utos_tester {
		compatible = "microtrust,tester-v1";
	};

	interrupt-controller@0c000000 {
		compatible = "arm,gic-v3";
		#interrupt-cells = <0x03>;
		#address-cells = <0x02>;
		#size-cells = <0x02>;
		#redistributor-regions = <0x01>;
		interrupt-parent = <0x16>;
		interrupt-controller;
		reg = <0x00 0xc000000 0x00 0x40000 0x00 0xc100000 0x00 0x200000 0x00 0x10200a80 0x00 0x50>;
		interrupts = <0x01 0x09 0x04>;
		phandle = <0x16>;
	};

	dcm@10001000 {
		compatible = "mediatek,mt6765-dcm";
		reg = <0x00 0x10001000 0x00 0x1000 0x00 0x10200000 0x00 0x1000 0x00 0x10200000 0x00 0x1000 0x00 0x10200200 0x00 0x1000 0x00 0x10200400 0x00 0x1000 0x00 0x1022d000 0x00 0x1000 0x00 0x10235000 0x00 0x1000 0x00 0x10238000 0x00 0x1000 0x00 0x11220000 0x00 0x1000 0x00 0x11c50000 0x00 0x1000 0x00 0x13000000 0x00 0x1000 0x00 0x14000000 0x00 0x1000 0x00 0x14002000 0x00 0x1000 0x00 0x14003000 0x00 0x1000 0x00 0x15021000 0x00 0x1000 0x00 0x17010000 0x00 0x1000 0x00 0x17020000 0x00 0x1000 0x00 0x17030000 0x00 0x1000>;
		reg-names = "infracfg_ao", "mcucfg", "mp0_cpucfg", "mp1_cpucfg", "mcu_misccfg", "chn0_emi", "chn1_emi", "gce", "audio", "efusec", "mfgcfg", "mmsys_config", "smi_common", "smi_larb0", "smi_larb2", "smi_larb1", "venc", "jpgenc";
		phandle = <0x6f>;
	};

	intpol-controller@10200a80 {
		compatible = "mediatek,mt6577-sysirq";
		interrupt-controller;
		#interrupt-cells = <0x03>;
		interrupt-parent = <0x16>;
		reg = <0x00 0x10200a80 0x00 0x50>;
		phandle = <0x01>;
	};

	infracfg_ao@10001000 {
		compatible = "mediatek,common-infracfg_ao", "mediatek,infracfg_ao", "mediatek,mt6765-infracfg", "syscon";
		reg = <0x00 0x10001000 0x00 0x1000>;
		interrupts = <0x00 0x93 0x01>;
		#clock-cells = <0x01>;
		phandle = <0x25>;
	};

	mcdi@00110100 {
		compatible = "mediatek,mt6765-mcdi";
		reg = <0x00 0x110100 0x00 0x800>;
	};

	scpsys@10001000 {
		compatible = "mediatek,mt6765-scpsys", "syscon";
		reg = <0x00 0x10001000 0x00 0x1000 0x00 0x10006000 0x00 0x1000 0x00 0x14002000 0x00 0x1000 0x00 0x1020e000 0x00 0x1000 0x00 0x18004000 0x00 0x1000 0x00 0x18002000 0x00 0x1000>;
		#clock-cells = <0x01>;
		phandle = <0x35>;
	};

	topckgen@10000000 {
		compatible = "mediatek,mt6765-topckgen", "syscon";
		reg = <0x00 0x10000000 0x00 0x1000>;
		#clock-cells = <0x01>;
		phandle = <0x26>;
	};

	scp_infra@10001000 {
		compatible = "mediatek,scpinfra";
		reg = <0x00 0x10001000 0x00 0x1000>;
		phandle = <0x70>;
	};

	io_cfg_lt@10002000 {
		compatible = "mediatek,io_cfg_lt";
		reg = <0x00 0x10002000 0x00 0x200>;
		phandle = <0x18>;
	};

	io_cfg_lm@10002200 {
		compatible = "mediatek,io_cfg_lm";
		reg = <0x00 0x10002200 0x00 0x200>;
		phandle = <0x19>;
	};

	io_cfg_lb@10002400 {
		compatible = "mediatek,io_cfg_lb";
		reg = <0x00 0x10002400 0x00 0x200>;
		phandle = <0x1a>;
	};

	io_cfg_bl@10002600 {
		compatible = "mediatek,io_cfg_bl";
		reg = <0x00 0x10002600 0x00 0x200>;
		phandle = <0x1b>;
	};

	io_cfg_rr@10002800 {
		compatible = "mediatek,io_cfg_rr";
		reg = <0x00 0x10002800 0x00 0x200>;
		phandle = <0x1c>;
	};

	io_cfg_rb@10002a00 {
		compatible = "mediatek,io_cfg_rb";
		reg = <0x00 0x10002a00 0x00 0x200>;
		phandle = <0x1d>;
	};

	io_cfg_rt@10002c00 {
		compatible = "mediatek,io_cfg_rt";
		reg = <0x00 0x10002c00 0x00 0x200>;
		phandle = <0x1e>;
	};

	pericfg@10003000 {
		compatible = "mediatek,pericfg", "syscon";
		reg = <0x00 0x10003000 0x00 0x1000>;
		#clock-cells = <0x01>;
		phandle = <0x4e>;
	};

	efuse_dbg@10004000 {
		compatible = "mediatek,efuse_dbg";
		reg = <0x00 0x10004000 0x00 0x1000>;
	};

	gpio {
		GPIO_SIM1_HOT_PLUG = <0x1f 0x2f 0x00>;
		GPIO_SIM2_HOT_PLUG = <0x1f 0x2e 0x00>;
		GPIO_SIM1_SIO = <0x1f 0x28 0x00>;
		GPIO_SIM1_SRST = <0x1f 0x27 0x00>;
		GPIO_SIM1_SCLK = <0x1f 0x26 0x00>;
		GPIO_SIM2_SCLK = <0x1f 0x25 0x00>;
		GPIO_SIM2_SRST = <0x1f 0x24 0x00>;
		GPIO_SIM2_SIO = <0x1f 0x23 0x00>;
		compatible = "mediatek,gpio_usage_mapping";
		phandle = <0x71>;
	};

	eint@1000b000 {
		compatible = "mediatek,eint";
		reg = <0x00 0x1000b000 0x00 0x1000>;
		phandle = <0x72>;
	};

	gpio@10005000 {
		gpio_init_default = <0x00 0x00 0x00 0x00 0x01 0x01 0x01 0x01 0x00 0x00 0x00 0x01 0x01 0x01 0x02 0x00 0x00 0x00 0x01 0x01 0x01 0x03 0x00 0x01 0x00 0x01 0x00 0x01 0x04 0x00 0x00 0x00 0x01 0x00 0x00 0x05 0x00 0x00 0x00 0x01 0x00 0x00 0x06 0x00 0x00 0x00 0x01 0x01 0x00 0x07 0x00 0x00 0x00 0x01 0x01 0x00 0x08 0x07 0x00 0x00 0x01 0x01 0x00 0x09 0x00 0x00 0x00 0x01 0x01 0x00 0x0a 0x00 0x00 0x00 0x01 0x00 0x00 0x0b 0x00 0x00 0x00 0x01 0x01 0x00 0x0c 0x00 0x00 0x00 0x01 0x01 0x00 0x0d 0x03 0x00 0x00 0x01 0x00 0x00 0x0e 0x03 0x01 0x00 0x00 0x00 0x00 0x0f 0x03 0x01 0x00 0x00 0x00 0x00 0x10 0x03 0x01 0x00 0x00 0x00 0x00 0x11 0x06 0x00 0x00 0x01 0x00 0x00 0x12 0x06 0x01 0x00 0x00 0x00 0x00 0x13 0x06 0x01 0x00 0x00 0x00 0x00 0x14 0x06 0x01 0x00 0x00 0x00 0x00 0x15 0x03 0x00 0x00 0x01 0x01 0x00 0x16 0x03 0x00 0x00 0x01 0x00 0x00 0x17 0x00 0x00 0x00 0x01 0x01 0x00 0x18 0x03 0x00 0x00 0x01 0x00 0x00 0x19 0x01 0x00 0x00 0x01 0x01 0x00 0x1a 0x01 0x00 0x00 0x01 0x01 0x00 0x1b 0x01 0x01 0x00 0x00 0x00 0x00 0x1c 0x01 0x00 0x00 0x01 0x01 0x00 0x1d 0x01 0x01 0x00 0x00 0x00 0x01 0x1e 0x01 0x00 0x00 0x01 0x01 0x01 0x1f 0x01 0x00 0x00 0x01 0x01 0x01 0x20 0x01 0x00 0x00 0x01 0x01 0x01 0x21 0x01 0x00 0x00 0x01 0x01 0x01 0x22 0x01 0x00 0x00 0x01 0x01 0x01 0x23 0x01 0x00 0x00 0x01 0x01 0x00 0x24 0x01 0x01 0x00 0x00 0x00 0x00 0x25 0x01 0x01 0x00 0x00 0x00 0x00 0x26 0x01 0x01 0x00 0x00 0x00 0x00 0x27 0x01 0x01 0x00 0x00 0x00 0x00 0x28 0x01 0x00 0x00 0x01 0x01 0x00 0x29 0x04 0x00 0x00 0x01 0x01 0x00 0x2a 0x04 0x01 0x00 0x00 0x00 0x00 0x2b 0x01 0x01 0x00 0x00 0x00 0x00 0x2c 0x01 0x00 0x00 0x01 0x00 0x00 0x2d 0x01 0x01 0x01 0x00 0x00 0x00 0x2e 0x01 0x00 0x00 0x01 0x01 0x00 0x2f 0x01 0x00 0x00 0x01 0x01 0x00 0x30 0x01 0x00 0x00 0x01 0x01 0x01 0x31 0x01 0x00 0x00 0x01 0x01 0x01 0x32 0x01 0x00 0x00 0x01 0x01 0x01 0x33 0x01 0x00 0x00 0x01 0x01 0x01 0x34 0x01 0x01 0x00 0x01 0x00 0x00 0x35 0x01 0x01 0x00 0x01 0x00 0x00 0x36 0x01 0x01 0x00 0x01 0x00 0x00 0x37 0x01 0x01 0x00 0x01 0x00 0x00 0x38 0x01 0x01 0x00 0x01 0x00 0x00 0x39 0x01 0x01 0x00 0x01 0x00 0x00 0x3a 0x00 0x00 0x00 0x01 0x00 0x00 0x3b 0x01 0x00 0x00 0x01 0x00 0x00 0x3c 0x01 0x00 0x00 0x01 0x00 0x00 0x3d 0x01 0x00 0x00 0x01 0x00 0x00 0x3e 0x01 0x00 0x00 0x01 0x00 0x00 0x3f 0x01 0x00 0x00 0x01 0x00 0x00 0x40 0x01 0x00 0x00 0x01 0x00 0x00 0x41 0x01 0x00 0x00 0x01 0x00 0x00 0x42 0x01 0x00 0x00 0x01 0x00 0x00 0x43 0x01 0x00 0x00 0x01 0x00 0x00 0x44 0x01 0x00 0x00 0x01 0x00 0x00 0x45 0x01 0x01 0x00 0x01 0x00 0x00 0x46 0x01 0x01 0x00 0x01 0x00 0x00 0x47 0x01 0x01 0x00 0x01 0x00 0x00 0x48 0x01 0x01 0x00 0x01 0x00 0x00 0x49 0x01 0x01 0x00 0x01 0x00 0x00 0x4a 0x01 0x01 0x00 0x01 0x00 0x00 0x4b 0x01 0x01 0x00 0x01 0x00 0x00 0x4c 0x01 0x01 0x00 0x01 0x00 0x00 0x4d 0x01 0x01 0x00 0x01 0x00 0x00 0x4e 0x01 0x01 0x00 0x01 0x00 0x00 0x4f 0x01 0x00 0x00 0x01 0x00 0x00 0x50 0x01 0x00 0x00 0x01 0x00 0x00 0x51 0x01 0x00 0x00 0x01 0x01 0x01 0x52 0x01 0x00 0x00 0x01 0x01 0x01 0x53 0x01 0x00 0x00 0x01 0x01 0x01 0x54 0x01 0x00 0x00 0x01 0x01 0x01 0x55 0x01 0x01 0x00 0x01 0x00 0x00 0x56 0x01 0x01 0x00 0x01 0x00 0x00 0x57 0x00 0x01 0x01 0x00 0x00 0x00 0x58 0x00 0x01 0x00 0x01 0x00 0x00 0x59 0x01 0x00 0x00 0x01 0x00 0x00 0x5a 0x02 0x01 0x00 0x00 0x00 0x00 0x5b 0x00 0x01 0x01 0x01 0x00 0x00 0x5c 0x01 0x01 0x00 0x00 0x00 0x00 0x5d 0x01 0x00 0x00 0x01 0x01 0x00 0x5e 0x01 0x00 0x00 0x01 0x01 0x00 0x5f 0x01 0x00 0x00 0x01 0x01 0x00 0x60 0x01 0x01 0x00 0x00 0x00 0x00 0x61 0x00 0x01 0x00 0x00 0x00 0x00 0x62 0x00 0x01 0x00 0x00 0x00 0x00 0x63 0x01 0x01 0x00 0x00 0x00 0x00 0x64 0x01 0x01 0x00 0x00 0x00 0x00 0x65 0x00 0x01 0x01 0x00 0x00 0x00 0x66 0x00 0x01 0x01 0x00 0x00 0x00 0x67 0x01 0x00 0x00 0x01 0x01 0x01 0x68 0x01 0x00 0x00 0x01 0x01 0x01 0x69 0x01 0x00 0x00 0x01 0x01 0x01 0x6a 0x01 0x00 0x00 0x01 0x01 0x01 0x6b 0x04 0x00 0x00 0x01 0x01 0x00 0x6c 0x01 0x01 0x00 0x00 0x00 0x00 0x6d 0x02 0x00 0x00 0x01 0x01 0x00 0x6e 0x00 0x00 0x00 0x01 0x01 0x00 0x6f 0x00 0x00 0x00 0x01 0x00 0x00 0x70 0x00 0x00 0x00 0x01 0x00 0x00 0x71 0x00 0x00 0x00 0x01 0x00 0x00 0x72 0x00 0x00 0x00 0x01 0x00 0x00 0x73 0x00 0x00 0x00 0x01 0x00 0x00 0x74 0x00 0x00 0x00 0x01 0x00 0x00 0x75 0x00 0x00 0x00 0x01 0x00 0x00 0x76 0x00 0x00 0x00 0x01 0x00 0x00 0x77 0x00 0x00 0x00 0x01 0x00 0x00 0x78 0x00 0x00 0x00 0x01 0x00 0x00 0x79 0x00 0x00 0x00 0x01 0x00 0x00 0x7a 0x01 0x00 0x00 0x01 0x01 0x01 0x7b 0x01 0x00 0x00 0x01 0x01 0x01 0x7c 0x01 0x01 0x00 0x00 0x00 0x01 0x7d 0x01 0x00 0x00 0x01 0x01 0x01 0x7e 0x01 0x00 0x00 0x01 0x01 0x01 0x7f 0x01 0x00 0x00 0x01 0x01 0x01 0x80 0x01 0x00 0x00 0x01 0x01 0x01 0x81 0x01 0x00 0x00 0x01 0x01 0x01 0x82 0x01 0x00 0x00 0x01 0x01 0x01 0x83 0x01 0x00 0x00 0x01 0x00 0x01 0x84 0x01 0x00 0x00 0x01 0x01 0x01 0x85 0x01 0x01 0x01 0x00 0x00 0x01 0x86 0x01 0x00 0x00 0x01 0x00 0x01 0x87 0x01 0x01 0x00 0x00 0x00 0x00 0x88 0x01 0x01 0x00 0x00 0x00 0x00 0x89 0x01 0x01 0x00 0x00 0x00 0x00 0x8a 0x01 0x01 0x00 0x00 0x00 0x00 0x8b 0x01 0x01 0x00 0x00 0x00 0x00 0x8c 0x01 0x00 0x00 0x01 0x00 0x00 0x8d 0x01 0x00 0x00 0x01 0x00 0x00 0x8e 0x01 0x00 0x00 0x01 0x00 0x00 0x8f 0x01 0x00 0x00 0x01 0x00 0x00 0x90 0x01 0x00 0x00 0x01 0x00 0x00 0x91 0x01 0x01 0x01 0x00 0x00 0x00 0x92 0x01 0x00 0x00 0x01 0x00 0x00 0x93 0x01 0x01 0x00 0x00 0x00 0x00 0x94 0x01 0x01 0x00 0x00 0x00 0x00 0x95 0x01 0x01 0x00 0x00 0x00 0x00 0x96 0x06 0x00 0x00 0x01 0x01 0x00 0x97 0x00 0x01 0x00 0x00 0x00 0x00 0x98 0x05 0x00 0x00 0x01 0x01 0x00 0x99 0x05 0x01 0x00 0x00 0x00 0x00 0x9a 0x00 0x01 0x01 0x00 0x00 0x00 0x9b 0x07 0x01 0x00 0x00 0x00 0x00 0x9c 0x07 0x00 0x00 0x01 0x00 0x00 0x9d 0x07 0x00 0x00 0x01 0x00 0x00 0x9e 0x07 0x00 0x00 0x01 0x00 0x00 0x9f 0x00 0x01 0x00 0x00 0x00 0x00 0xa0 0x00 0x01 0x00 0x00 0x00 0x00 0xa1 0x01 0x00 0x00 0x01 0x01 0x01 0xa2 0x01 0x00 0x00 0x01 0x01 0x01 0xa3 0x00 0x00 0x00 0x00 0x00 0x00 0xa4 0x00 0x00 0x00 0x01 0x00 0x00 0xa5 0x00 0x00 0x00 0x01 0x00 0x00 0xa6 0x00 0x00 0x00 0x01 0x00 0x00 0xa7 0x00 0x00 0x00 0x01 0x00 0x00 0xa8 0x00 0x00 0x00 0x01 0x00 0x00 0xa9 0x00 0x01 0x00 0x00 0x00 0x00 0xaa 0x00 0x01 0x00 0x00 0x00 0x00 0xab 0x00 0x00 0x00 0x01 0x00 0x00 0xac 0x00 0x01 0x01 0x00 0x00 0x00 0xad 0x00 0x01 0x00 0x00 0x00 0x00 0xae 0x00 0x01 0x01 0x00 0x00 0x00 0xaf 0x00 0x01 0x00 0x00 0x00 0x00 0xb0 0x00 0x01 0x00 0x00 0x00 0x00 0xb1 0x00 0x01 0x00 0x00 0x00 0x00 0xb2 0x00 0x01 0x00 0x00 0x00 0x00 0xb3 0x00 0x00 0x00 0x01 0x00 0x00>;
		compatible = "mediatek,gpio", "syscon";
		reg = <0x00 0x10005000 0x00 0x1000>;
		phandle = <0x17>;
	};

	pinctrl@1000b000 {
		compatible = "mediatek,mt6765-pinctrl";
		reg_bases = <0x17 0x18 0x19 0x1a 0x1b 0x1c 0x1d 0x1e>;
		pins-are-numbered;
		gpio-controller;
		gpio-ranges = <0x1f 0x00 0x00 0xb3>;
		#gpio-cells = <0x02>;
		interrupt-controller;
		#interrupt-cells = <0x02>;
		interrupts = <0x00 0xab 0x04>;
		interrupt-parent = <0x16>;
		phandle = <0x1f>;

		camdefault {
			phandle = <0x126>;
		};

		cam2@vcama1 {
			phandle = <0x139>;
		};

		cam2@vcama0 {
			phandle = <0x13a>;
		};

		cam1@vcama1 {
			phandle = <0x137>;

			pins_cmd_dat {
				output-high;
				slew-rate = <0x01>;
				pinmux = <0xa900>;
			};
		};

		cam1@vcama0 {
			phandle = <0x138>;

			pins_cmd_dat {
				output-low;
				slew-rate = <0x01>;
				pinmux = <0xa900>;
			};
		};

		cam1@vcamd1 {
			phandle = <0x135>;

			pins_cmd_dat {
				output-high;
				slew-rate = <0x01>;
				pinmux = <0xaa00>;
			};
		};

		cam1@vcamd0 {
			phandle = <0x136>;

			pins_cmd_dat {
				output-low;
				slew-rate = <0x01>;
				pinmux = <0xaa00>;
			};
		};

		cam0@vcamd1 {
			phandle = <0x133>;

			pins_cmd_dat {
				output-high;
				slew-rate = <0x01>;
				pinmux = <0x5800>;
			};
		};

		cam0@vcamd0 {
			phandle = <0x134>;

			pins_cmd_dat {
				output-low;
				slew-rate = <0x01>;
				pinmux = <0x5800>;
			};
		};

		cam2@3 {
			phandle = <0x132>;

			pins_cmd_dat {
				output-high;
				slew-rate = <0x01>;
				pinmux = <0xa000>;
			};
		};

		cam2@2 {
			phandle = <0x131>;

			pins_cmd_dat {
				output-low;
				slew-rate = <0x01>;
				pinmux = <0xa000>;
			};
		};

		cam2@1 {
			phandle = <0x130>;

			pins_cmd_dat {
				output-high;
				slew-rate = <0x01>;
				pinmux = <0x5700>;
			};
		};

		cam2@0 {
			phandle = <0x12f>;

			pins_cmd_dat {
				output-low;
				slew-rate = <0x01>;
				pinmux = <0x5700>;
			};
		};

		cam1@3 {
			phandle = <0x12e>;

			pins_cmd_dat {
				output-high;
				slew-rate = <0x01>;
				pinmux = <0x6200>;
			};
		};

		cam1@2 {
			phandle = <0x12d>;

			pins_cmd_dat {
				output-low;
				slew-rate = <0x01>;
				pinmux = <0x6200>;
			};
		};

		cam1@1 {
			phandle = <0x12c>;

			pins_cmd_dat {
				output-high;
				slew-rate = <0x01>;
				pinmux = <0x6600>;
			};
		};

		cam1@0 {
			phandle = <0x12b>;

			pins_cmd_dat {
				output-low;
				slew-rate = <0x01>;
				pinmux = <0x6600>;
			};
		};

		cam0@3 {
			phandle = <0x12a>;

			pins_cmd_dat {
				output-high;
				slew-rate = <0x01>;
				pinmux = <0x6100>;
			};
		};

		cam0@2 {
			phandle = <0x129>;

			pins_cmd_dat {
				output-low;
				slew-rate = <0x01>;
				pinmux = <0x6100>;
			};
		};

		cam0@1 {
			phandle = <0x128>;

			pins_cmd_dat {
				output-high;
				slew-rate = <0x01>;
				pinmux = <0x6500>;
			};
		};

		cam0@0 {
			phandle = <0x127>;

			pins_cmd_dat {
				output-low;
				slew-rate = <0x01>;
				pinmux = <0x6500>;
			};
		};

		camera_pins_cam2_mclk_off {
			phandle = <0x140>;

			pins_cmd_dat {
				pinmux = <0x6c00>;
			};
		};

		camera_pins_cam2_mclk_on {
			phandle = <0x13f>;

			pins_cmd_dat {
				pinmux = <0x6c01>;
			};
		};

		camera_pins_cam1_mclk_off {
			phandle = <0x13e>;

			pins_cmd_dat {
				pinmux = <0x6400>;
			};
		};

		camera_pins_cam1_mclk_on {
			phandle = <0x13d>;

			pins_cmd_dat {
				pinmux = <0x6401>;
			};
		};

		camera_pins_cam0_mclk_off {
			phandle = <0x13c>;

			pins_cmd_dat {
				pinmux = <0x6300>;
			};
		};

		camera_pins_cam0_mclk_on {
			phandle = <0x13b>;

			pins_cmd_dat {
				pinmux = <0x6301>;
			};
		};

		output1 {
			phandle = <0x125>;

			pins_cmd_dat {
				output-high;
				slew-rate = <0x01>;
				pinmux = <0xa400>;
			};
		};

		output0 {
			phandle = <0x124>;

			pins_cmd_dat {
				output-low;
				slew-rate = <0x01>;
				pinmux = <0xa400>;
			};
		};

		extamp@1 {
			phandle = <0x123>;

			pins_cmd_dat {
				output-high;
				slew-rate = <0x01>;
				pinmux = <0x9f00>;
			};
		};

		extamp@0 {
			phandle = <0x122>;

			pins_cmd_dat {
				output-low;
				slew-rate = <0x01>;
				pinmux = <0x9f00>;
			};
		};

		aud_pins_smartpa_on {
			phandle = <0x121>;

			pins_cmd3_dat {
				pinmux = <0x1406>;
			};

			pins_cmd2_dat {
				pinmux = <0x1306>;
			};

			pins_cmd1_dat {
				pinmux = <0x1206>;
			};

			pins_cmd0_dat {
				pinmux = <0x1106>;
			};
		};

		aud_pins_smartpa_off {
			phandle = <0x120>;

			pins_cmd3_dat {
				pinmux = <0x1400>;
			};

			pins_cmd2_dat {
				pinmux = <0x1300>;
			};

			pins_cmd1_dat {
				pinmux = <0x1200>;
			};

			pins_cmd0_dat {
				pinmux = <0x1100>;
			};
		};

		aud_dat_miso_on {
			phandle = <0x11f>;

			pins_cmd2_dat {
				pinmux = <0x8f01>;
			};

			pins_cmd1_dat {
				pinmux = <0x8e01>;
			};
		};

		aud_dat_miso_off {
			phandle = <0x11e>;

			pins_cmd2_dat {
				bias-disable;
				slew-rate = <0x00>;
				input-enable;
				pinmux = <0x8f00>;
			};

			pins_cmd1_dat {
				bias-disable;
				slew-rate = <0x00>;
				input-enable;
				pinmux = <0x8e00>;
			};
		};

		aud_dat_mosi_on {
			phandle = <0x11d>;

			pins_cmd2_dat {
				pinmux = <0x8b01>;
			};

			pins_cmd1_dat {
				pinmux = <0x8a01>;
			};
		};

		aud_dat_mosi_off {
			phandle = <0x11c>;

			pins_cmd2_dat {
				bias-disable;
				slew-rate = <0x00>;
				input-enable;
				pinmux = <0x8b00>;
			};

			pins_cmd1_dat {
				bias-disable;
				slew-rate = <0x00>;
				input-enable;
				pinmux = <0x8a00>;
			};
		};

		aud_clk_miso_on {
			phandle = <0x11b>;

			pins_cmd0_dat {
				pinmux = <0x8c01>;
			};
		};

		aud_clk_miso_off {
			phandle = <0x11a>;

			pins_cmd0_dat {
				pinmux = <0x8c00>;
			};
		};

		aud_clk_mosi_on {
			phandle = <0x119>;

			pins_cmd0_dat {
				pinmux = <0x8801>;
			};
		};

		aud_clk_mosi_off {
			phandle = <0x118>;

			pins_cmd0_dat {
				pinmux = <0x8800>;
			};
		};

		irtx_gpio_led_set@gpio90 {
			phandle = <0x117>;

			pins_cmd_dat {
				output-high;
				slew-rate = <0x01>;
				pinmux = <0x5a02>;
			};
		};

		irtx_gpio_led_def@gpio90 {
			phandle = <0x116>;

			pins_cmd_dat {
				input-schmitt-enable = <0x00>;
				output-low;
				bias-disable;
				slew-rate = <0x01>;
				pinmux = <0x5a00>;
			};
		};

		state_reset_low {
			phandle = <0x115>;

			pins_cmd_dat {
				output-low;
				slew-rate = <0x01>;
				pinmux = <0xac00>;
			};
		};

		state_reset_high {
			phandle = <0x114>;

			pins_cmd_dat {
				output-high;
				slew-rate = <0x01>;
				pinmux = <0xac00>;
			};
		};

		state_default {
			phandle = <0x113>;
		};

		accdetswitch_low {
			phandle = <0x112>;

			pins_cmd_dat {
				output-low;
				slew-rate = <0x01>;
				pinmux = <0x9700>;
			};
		};

		accdetswitch_high {
			phandle = <0x111>;

			pins_cmd_dat {
				output-high;
				slew-rate = <0x01>;
				pinmux = <0x9700>;
			};
		};

		accdeteint@0 {
			phandle = <0x110>;

			pins_cmd_dat {
				bias-disable;
				slew-rate = <0x00>;
				pinmux = <0xc00>;
			};
		};

		accdetdefault {
			phandle = <0x10f>;
		};

		kpdgpiodefault {
			phandle = <0x10e>;

			pins_cmd_dat {
				input-schmitt-enable;
				output-low;
				bias-pull-up = <0x66>;
				pinmux = <0x5d01>;
			};
		};

		gpslna@2 {
			phandle = <0x10d>;

			pins_cmd_dat {
				output-low;
				slew-rate = <0x01>;
				pinmux = <0x300>;
			};
		};

		gpslna@1 {
			phandle = <0x10c>;

			pins_cmd_dat {
				output-high;
				slew-rate = <0x01>;
				pinmux = <0x300>;
			};
		};

		gpslna@0 {
			phandle = <0x10b>;

			pins_cmd_dat {
				output-low;
				bias-disable;
				slew-rate = <0x00>;
				pinmux = <0x300>;
			};
		};

		consys_default {
			phandle = <0x10a>;
		};

		rstoutput1 {
			phandle = <0x109>;

			pins_cmd_dat {
				output-high;
				slew-rate = <0x01>;
				pinmux = <0xae00>;
			};
		};

		rstoutput0 {
			phandle = <0x108>;

			pins_cmd_dat {
				output-low;
				slew-rate = <0x01>;
				pinmux = <0xae00>;
			};
		};

		eintoutput1 {
			phandle = <0x107>;

			pins_cmd_dat {
				output-high;
				slew-rate = <0x01>;
				pinmux = <0x00>;
			};
		};

		eintoutput0 {
			phandle = <0x106>;

			pins_cmd_dat {
				output-low;
				slew-rate = <0x01>;
				pinmux = <0x00>;
			};
		};

		eint@0 {
			phandle = <0x105>;

			pins_cmd_dat {
				bias-disable;
				slew-rate = <0x00>;
				pinmux = <0x00>;
			};
		};

		eint0default {
			phandle = <0x104>;
		};

		dispdefault {
			phandle = <0xfd>;
		};

		lcd_bias_enn1_gpio {
			phandle = <0x103>;

			pins_cmd_dat {
				output-high;
				slew-rate = <0x01>;
				pinmux = <0x9600>;
			};
		};

		lcd_bias_enn0_gpio {
			phandle = <0x102>;

			pins_cmd_dat {
				output-low;
				slew-rate = <0x01>;
				pinmux = <0x9600>;
			};
		};

		lcd_bias_enp1_gpio {
			phandle = <0x101>;

			pins_cmd_dat {
				output-high;
				slew-rate = <0x01>;
				pinmux = <0x9600>;
			};
		};

		lcd_bias_enp0_gpio {
			phandle = <0x100>;

			pins_cmd_dat {
				output-low;
				slew-rate = <0x01>;
				pinmux = <0x9600>;
			};
		};

		lcm_rst_out1_gpio {
			phandle = <0xff>;

			pins_cmd_dat {
				output-high;
				slew-rate = <0x01>;
				pinmux = <0x2d00>;
			};
		};

		lcm_rst_out0_gpio {
			phandle = <0xfe>;

			pins_cmd_dat {
				output-low;
				slew-rate = <0x01>;
				pinmux = <0x2d00>;
			};
		};

		msdc0@default {
			phandle = <0x51>;

			pins_cmd {
				drive-strength = [03];
			};

			pins_dat {
				drive-strength = [03];
			};

			pins_clk {
				drive-strength = [03];
			};

			pins_rst {
				drive-strength = [03];
			};

			pins_ds {
				drive-strength = [03];
			};
		};

		msdc0@hs400 {
			phandle = <0x52>;

			pins_cmd {
				drive-strength = [03];
			};

			pins_dat {
				drive-strength = [04];
			};

			pins_clk {
				drive-strength = [04];
			};

			pins_rst {
				drive-strength = [03];
			};

			pins_ds {
				drive-strength = [04];
			};
		};

		msdc0@hs200 {
			phandle = <0x53>;

			pins_cmd {
				drive-strength = [03];
			};

			pins_dat {
				drive-strength = [04];
			};

			pins_clk {
				drive-strength = [04];
			};

			pins_rst {
				drive-strength = [03];
			};

			pins_ds {
				drive-strength = [04];
			};
		};

		msdc0@register_default {
			cmd_edge = [00];
			rdata_edge = [00];
			wdata_edge = [00];
			phandle = <0x54>;
		};

		msdc1@default {
			phandle = <0x56>;

			pins_cmd {
				drive-strength = [03];
			};

			pins_dat {
				drive-strength = [03];
			};

			pins_clk {
				drive-strength = [03];
			};
		};

		msdc1@sdr104 {
			phandle = <0x57>;

			pins_cmd {
				drive-strength = [03];
			};

			pins_dat {
				drive-strength = [03];
			};

			pins_clk {
				drive-strength = [03];
			};
		};

		msdc1@sdr50 {
			phandle = <0x58>;

			pins_cmd {
				drive-strength = [03];
			};

			pins_dat {
				drive-strength = [03];
			};

			pins_clk {
				drive-strength = [03];
			};
		};

		msdc1@ddr50 {
			phandle = <0x59>;

			pins_cmd {
				drive-strength = [03];
			};

			pins_dat {
				drive-strength = [03];
			};

			pins_clk {
				drive-strength = [03];
			};
		};

		msdc1@register_default {
			cmd_edge = [00];
			rdata_edge = [00];
			wdata_edge = [00];
			phandle = <0x5a>;
		};

		msdc3@default {
			phandle = <0x73>;

			pins_cmd {
				drive-strength = [04];
			};

			pins_dat {
				drive-strength = [04];
			};

			pins_clk {
				drive-strength = [04];
			};
		};

		msdc3@register_default {
			cmd_edge = [01];
			rdata_edge = [01];
			wdata_edge = [01];
			phandle = <0x74>;
		};
	};

	sleep@10006000 {
		compatible = "mediatek,sleep", "syscon";
		reg = <0x00 0x10006000 0x00 0x1000>;
		interrupts = <0x00 0xb5 0x08>;
		wakeup-source = <0x20 0x00 0x04 0x21 0x01 0x20 0x22 0x03 0x2000000>;
		phandle = <0x6a>;
	};

	toprgu@10007000 {
		compatible = "mediatek,mt6765-wdt", "mediatek,mt6589-wdt", "mediatek,toprgu", "syscon", "simple-mfd";
		reg = <0x00 0x10007000 0x00 0x1000>;
		interrupts = <0x00 0x8b 0x00>;
		mediatek,rg_dfd_timeout = <0xa0>;
		#reset-cells = <0x01>;
		phandle = <0x48>;

		reboot-mode {
			compatible = "syscon-reboot-mode";
			offset = <0x24>;
			mask = <0x0f>;
			mode-charger = <0x01>;
			mode-recovery = <0x02>;
			mode-bootloader = <0x03>;
			mode-dm-verity-dev-corrupt = <0x04>;
			mode-kpoc = <0x05>;
			mode-ddr-reserve = <0x06>;
			mode-meta = <0x07>;
			mode-rpmbpk = <0x08>;
		};
	};

	chipid@08000000 {
		compatible = "mediatek,chipid";
		reg = <0x00 0x8000000 0x00 0x04 0x00 0x8000004 0x00 0x04 0x00 0x8000008 0x00 0x04 0x00 0x800000c 0x00 0x04>;
	};

	hwrng {
		compatible = "mediatek,mt67xx-rng";
		phandle = <0x75>;
	};

	mobicore {
		compatible = "trustonic,mobicore";
		interrupts = <0x00 0x10f 0x01>;
	};

	tee_sanity {
		compatible = "trustonic,tee_sanity";
		interrupts = <0x00 0x110 0x01>;
	};

	tkcore {
		compatible = "trustkernel,tkcore";
		interrupts = <0x00 0xf8 0x01>;
	};

	timer {
		compatible = "arm,armv8-timer";
		interrupt-parent = <0x16>;
		interrupts = <0x01 0x0d 0x08 0x01 0x0e 0x08 0x01 0x0b 0x08 0x01 0x0a 0x08>;
		clock-frequency = <0xc65d40>;
	};

	clocks {

		clk26m {
			compatible = "fixed-clock";
			#clock-cells = <0x00>;
			clock-frequency = <0x18cba80>;
			phandle = <0x24>;
		};

		clk13m {
			compatible = "fixed-clock";
			#clock-cells = <0x00>;
			clock-frequency = <0xc65d40>;
			phandle = <0x34>;
		};

		clk32k {
			compatible = "fixed-clock";
			#clock-cells = <0x00>;
			clock-frequency = <0x7d00>;
			phandle = <0x23>;
		};
	};

	apxgpt@10008000 {
		compatible = "mediatek,apxgpt";
		reg = <0x00 0x10008000 0x00 0x1000>;
		interrupts = <0x00 0xaa 0x08>;
		clocks = <0x23>;
	};

	hacc@1000a000 {
		compatible = "mediatek,hacc";
		reg = <0x00 0x1000a000 0x00 0x1000>;
		interrupts = <0x00 0xbd 0x08>;
	};

	apmixed@1000c000 {
		compatible = "mediatek,mt6765-apmixedsys", "syscon";
		reg = <0x00 0x1000c000 0x00 0xe00>;
		#clock-cells = <0x01>;
		phandle = <0x03>;
	};

	fhctl@1000ce00 {
		compatible = "mediatek,mt6765-fhctl";
		reg = <0x00 0x1000ce00 0x00 0x100>;
		mediatek,apmixed = <0x03>;

		armpll {
			mediatek,fh-id = <0x00>;
			mediatek,fh-pll-id = <0x01>;
			mediatek,fh-cpu-pll;
		};

		mainpll {
			mediatek,fh-id = <0x01>;
			mediatek,fh-pll-id = <0x03>;
		};

		msdcpll {
			mediatek,fh-id = <0x02>;
			mediatek,fh-pll-id = <0x07>;
		};

		mfgpll {
			mediatek,fh-id = <0x03>;
			mediatek,fh-pll-id = <0x04>;
		};

		mpll {
			mediatek,fh-id = <0x05>;
			mediatek,fh-pll-id = <0x09>;
		};

		mmpll {
			mediatek,fh-id = <0x06>;
			mediatek,fh-pll-id = <0x05>;
		};

		armpll_l {
			mediatek,fh-id = <0x07>;
			mediatek,fh-pll-id = <0x00>;
			mediatek,fh-cpu-pll;
		};
	};

	pwrap@1000d000 {
		compatible = "mediatek,mt6765-pwrap", "syscon";
		reg = <0x00 0x1000d000 0x00 0x1000>;
		reg-names = "pwrap";
		interrupts = <0x00 0xb3 0x04>;
		clocks = <0x24 0x25 0x02 0x26 0x7c>;
		clock-names = "spi", "wrap", "ulposc";
		phandle = <0x2f>;

		main_pmic {
			status = "okay";
			compatible = "mediatek,mt6357";
			interrupt-controller;
			#interrupt-cells = <0x02>;
			interrupt-parent = <0x1f>;
			interrupts = <0x90 0x04 0x90 0x01>;
			phandle = <0x30>;

			mtk_battery_oc_throttling {
				compatible = "mediatek,mt6357-battery_oc_throttling";
				oc-thd-h = <0x123e>;
				oc-thd-l = <0x157c>;
			};

			pmic_accdet {
				debounce = <0x3e800>;
				deb-gpios = <0x1f 0x0c 0x00>;
				pinctrl-3 = <0x112>;
				pinctrl-2 = <0x111>;
				pinctrl-1 = <0x110>;
				pinctrl-0 = <0x10f>;
				pinctrl-names = "default", "state_eint_as_int", "mic_switch_pin_high", "mic_switch_pin_low";
				compatible = "mediatek,mt6357-accdet";
				accdet-name = "mt63xx-accdet";
				accdet-mic-vol = <0x06>;
				accdet-plugout-debounce = <0x01>;
				accdet-mic-mode = <0x01>;
				headset-mode-setting = <0x500 0x500 0x01 0x1f0 0x800 0x800 0x20 0x44>;
				headset-eint-level-pol = <0x08>;
				headset-use-ap-eint = <0x00>;
				headset-eint-num = <0x00>;
				headset-eint-trig-mode = <0x00>;
				headset-key-mode = <0x00>;
				headset-three-key-threshold = <0x00 0x50 0xdc 0x190>;
				headset-three-key-threshold-CDD = <0x00 0x79 0xc0 0x258>;
				headset-four-key-threshold = <0x00 0x3a 0x79 0xc0 0x190>;
				io-channels = <0x27 0x09>;
				io-channel-names = "pmic_accdet";
				nvmem = <0x28>;
				nvmem-names = "mt63xx-accdet-efuse";
				status = "okay";
				phandle = <0x76>;
			};

			mt6357keys {
				compatible = "mediatek,mt6357-keys";
				mediatek,long-press-mode = <0x01>;
				power-off-time-sec = <0x00>;
				phandle = <0x77>;

				power {
					linux,keycodes = <0x74>;
					wakeup-source;
				};

				home {
					linux,keycodes = <0x73>;
				};
			};

			pmic_auxadc {
				compatible = "mediatek,pmic-auxadc", "mediatek,mt6357-auxadc";
				#io-channel-cells = <0x01>;
				#interconnect-cells = <0x01>;
				phandle = <0x27>;

				batadc {
					channel = <0x00>;
					resistance-ratio = <0x03 0x01>;
					avg-num = <0x80>;
				};

				isense {
					channel = <0x01>;
					resistance-ratio = <0x03 0x01>;
					avg-num = <0x80>;
				};

				vcdt {
					channel = <0x02>;
				};

				bat_temp {
					channel = <0x03>;
					resistance-ratio = <0x01 0x01>;
				};

				chip_temp {
					channel = <0x05>;
				};

				vcore_temp {
					channel = <0x06>;
				};

				vproc_temp {
					channel = <0x07>;
				};

				accdet {
					channel = <0x09>;
				};

				tsx_temp {
					channel = <0x0b>;
					avg-num = <0x80>;
				};

				hpofs_cal {
					channel = <0x0c>;
					avg-num = <0x100>;
				};

				dcxo_temp {
					channel = <0x0d>;
					avg-num = <0x10>;
				};

				vbif {
					channel = <0x0e>;
					resistance-ratio = <0x01 0x01>;
				};

				imp {
					channel = <0x0f>;
					resistance-ratio = <0x03 0x01>;
					avg-num = <0x80>;
				};

				imix_r {
					channel = <0x10>;
				};
			};

			mtk_gauge {
				compatible = "mediatek,mt6357-gauge";
				charger = <0x78>;
				bootmode = <0x2a>;
				io-channels = <0x27 0x03 0x27 0x01 0x27 0x0e 0x27 0x0f 0x27 0x10>;
				io-channel-names = "pmic_battery_temp", "pmic_battery_voltage", "pmic_bif_voltage", "pmic_ptim_voltage", "pmic_ptim_r";
				nvmem-cells = <0x2b 0x2c>;
				nvmem-cell-names = "initialization", "state-of-charge";
				DIFFERENCE_FULLOCV_ITH = <0xc8>;
				SHUTDOWN_1_TIME = <0x14>;
				KEEP_100_PERCENT = <0x01>;
				R_FG_VALUE = <0x0a>;
				EMBEDDED_SEL = <0x01>;
				PMIC_SHUTDOWN_CURRENT = <0x14>;
				FG_METER_RESISTANCE = <0x4b>;
				CAR_TUNE_VALUE = <0x64>;
				PMIC_MIN_VOL = <0x7ef4>;
				POWERON_SYSTEM_IBOOT = <0x1f4>;
				SHUTDOWN_GAUGE0_VOLTAGE = <0x8340>;
				TEMPERATURE_T0 = <0x32>;
				TEMPERATURE_T1 = <0x19>;
				TEMPERATURE_T2 = <0x0a>;
				TEMPERATURE_T3 = <0x00>;
				TEMPERATURE_T4 = <0xfffffffa>;
				TEMPERATURE_T5 = <0xfffffff6>;
				g_FG_PSEUDO100_T0 = <0x66>;
				g_FG_PSEUDO100_T1 = <0x66>;
				g_FG_PSEUDO100_T2 = <0x66>;
				g_FG_PSEUDO100_T3 = <0x66>;
				g_FG_PSEUDO100_T4 = <0x66>;
				Q_MAX_SYS_VOLTAGE_BAT0 = <0xcb2>;
				Q_MAX_SYS_VOLTAGE_BAT1 = <0xcb2>;
				Q_MAX_SYS_VOLTAGE_BAT2 = <0xcb2>;
				Q_MAX_SYS_VOLTAGE_BAT3 = <0xcb2>;
				COM_FG_METER_RESISTANCE = <0x64>;
				COM_R_FG_VALUE = <0x00>;
				enable_tmp_intr_suspend = <0x00>;
				ACTIVE_TABLE = <0x06>;
				MULTI_TEMP_GAUGE0 = <0x01>;
				RBAT_PULL_UP_R = <0x4204>;
				RBAT_PULL_UP_VOLT = <0x708>;
				battery0_profile_t0_num = <0x64>;
				battery0_profile_t0_col = <0x03>;
				battery0_profile_t0 = <0x00 0xab26 0x2ee 0x118 0xa946 0x2ee 0x230 0xa7b2 0x2ee 0x339 0xa670 0x2ee 0x442 0xa504 0x2e4 0x550 0xa39b 0x2f8 0x65e 0xa28c 0x2ee 0x758 0xa1e2 0x2ee 0x85c 0xa13e 0x2ee 0x96a 0xa032 0x2ee 0xa6e 0x9f8e 0x2f8 0xb79 0x9eed 0x302 0xc84 0x9f17 0x316 0xd8f 0x9e78 0x320 0xe9a 0x9dda 0x32a 0xfa5 0x9d3f 0x334 0x10b0 0x9ca7 0x352 0x11bb 0x9c40 0x35c 0x12c6 0x9bdc 0x370 0x13d1 0x9bab 0x384 0x14dc 0x9b22 0x3ac 0x15e7 0x9acf 0x3ac 0x16f2 0x9a6a 0x3b6 0x17fd 0x9a42 0x3de 0x1908 0x99e8 0x398 0x1a13 0x9984 0x3c0 0x1b1e 0x9958 0x3a2 0x1c29 0x9920 0x3c0 0x1d34 0x98ee 0x398 0x1e3f 0x98bc 0x398 0x1f4a 0x9880 0x3de 0x2055 0x9858 0x38e 0x2160 0x9826 0x398 0x226b 0x97f4 0x398 0x2376 0x97ad 0x366 0x2481 0x9744 0x348 0x258c 0x96e7 0x334 0x2697 0x9690 0x32a 0x27a2 0x9643 0x32a 0x28ad 0x95ff 0x32a 0x29b8 0x95ba 0x32a 0x2ac3 0x957c 0x334 0x2bce 0x9541 0x33e 0x2cd9 0x950a 0x352 0x2de4 0x94d8 0x352 0x2eef 0x94a6 0x35c 0x2ffa 0x9475 0x366 0x3105 0x944d 0x37a 0x3210 0x9424 0x3de 0x331b 0x93ff 0x38e 0x3426 0x93d7 0x38e 0x3531 0x93b2 0x38e 0x363c 0x9389 0x38e 0x3747 0x935e 0x37a 0x3852 0x9332 0x366 0x395d 0x9307 0x352 0x3a68 0x92d5 0x352 0x3b73 0x929b 0x334 0x3c7e 0x926c 0x334 0x3d89 0x923d 0x33e 0x3e94 0x9209 0x35c 0x3f9f 0x91bb 0x352 0x40aa 0x9161 0x33e 0x41b5 0x911a 0x35c 0x3fac 0x90b7 0x35c 0x4268 0x9057 0x348 0x4330 0x903e 0x352 0x4650 0x9032 0x370 0x4970 0x9022 0x3c0 0x4c90 0x9009 0x3c0 0x4f4c 0x8f68 0x3d4 0x5208 0x8d3a 0x3a2 0x53fc 0x8a08 0x3ca 0x55f0 0x8507 0x3de>;
				battery0_profile_t1_num = <0x64>;
				battery0_profile_t1_col = <0x03>;
				battery0_profile_t1 = <0x00 0xab26 0x2ee 0x118 0xa946 0x2ee 0x230 0xa7b2 0x2ee 0x339 0xa670 0x2ee 0x442 0xa504 0x2e4 0x550 0xa39b 0x2f8 0x65e 0xa28c 0x2ee 0x758 0xa1e2 0x2ee 0x85c 0xa13e 0x2ee 0x96a 0xa032 0x2ee 0xa6e 0x9f8e 0x2f8 0xb79 0x9eed 0x302 0xc84 0x9f17 0x316 0xd8f 0x9e78 0x320 0xe9a 0x9dda 0x32a 0xfa5 0x9d3f 0x334 0x10b0 0x9ca7 0x352 0x11bb 0x9c40 0x35c 0x12c6 0x9bdc 0x370 0x13d1 0x9bab 0x384 0x14dc 0x9b22 0x3ac 0x15e7 0x9acf 0x3ac 0x16f2 0x9a6a 0x3b6 0x17fd 0x9a42 0x3de 0x1908 0x99e8 0x398 0x1a13 0x9984 0x3c0 0x1b1e 0x9958 0x3a2 0x1c29 0x9920 0x3c0 0x1d34 0x98ee 0x398 0x1e3f 0x98bc 0x398 0x1f4a 0x9880 0x3de 0x2055 0x9858 0x38e 0x2160 0x9826 0x398 0x226b 0x97f4 0x398 0x2376 0x97ad 0x366 0x2481 0x9744 0x348 0x258c 0x96e7 0x334 0x2697 0x9690 0x32a 0x27a2 0x9643 0x32a 0x28ad 0x95ff 0x32a 0x29b8 0x95ba 0x32a 0x2ac3 0x957c 0x334 0x2bce 0x9541 0x33e 0x2cd9 0x950a 0x352 0x2de4 0x94d8 0x352 0x2eef 0x94a6 0x35c 0x2ffa 0x9475 0x366 0x3105 0x944d 0x37a 0x3210 0x9424 0x3de 0x331b 0x93ff 0x38e 0x3426 0x93d7 0x38e 0x3531 0x93b2 0x38e 0x363c 0x9389 0x38e 0x3747 0x935e 0x37a 0x3852 0x9332 0x366 0x395d 0x9307 0x352 0x3a68 0x92d5 0x352 0x3b73 0x929b 0x334 0x3c7e 0x926c 0x334 0x3d89 0x923d 0x33e 0x3e94 0x9209 0x35c 0x3f9f 0x91bb 0x352 0x40aa 0x9161 0x33e 0x41b5 0x911a 0x35c 0x3fac 0x90b7 0x35c 0x4268 0x9057 0x348 0x4330 0x903e 0x352 0x4650 0x9032 0x370 0x4970 0x9022 0x3c0 0x4c90 0x9009 0x3c0 0x4f4c 0x8f68 0x3d4 0x5208 0x8d3a 0x3a2 0x53fc 0x8a08 0x3ca 0x55f0 0x8507 0x3de>;
				battery0_profile_t2_num = <0x64>;
				battery0_profile_t2_col = <0x03>;
				battery0_profile_t2 = <0x00 0xab26 0x2ee 0x118 0xa946 0x2ee 0x230 0xa7b2 0x2ee 0x339 0xa670 0x2ee 0x442 0xa504 0x2e4 0x550 0xa39b 0x2f8 0x65e 0xa28c 0x2ee 0x758 0xa1e2 0x2ee 0x85c 0xa13e 0x2ee 0x96a 0xa032 0x2ee 0xa6e 0x9f8e 0x2f8 0xb79 0x9eed 0x302 0xc84 0x9f17 0x316 0xd8f 0x9e78 0x320 0xe9a 0x9dda 0x32a 0xfa5 0x9d3f 0x334 0x10b0 0x9ca7 0x352 0x11bb 0x9c40 0x35c 0x12c6 0x9bdc 0x370 0x13d1 0x9bab 0x384 0x14dc 0x9b22 0x3ac 0x15e7 0x9acf 0x3ac 0x16f2 0x9a6a 0x3b6 0x17fd 0x9a42 0x3de 0x1908 0x99e8 0x398 0x1a13 0x9984 0x3c0 0x1b1e 0x9958 0x3a2 0x1c29 0x9920 0x3c0 0x1d34 0x98ee 0x398 0x1e3f 0x98bc 0x398 0x1f4a 0x9880 0x3de 0x2055 0x9858 0x38e 0x2160 0x9826 0x398 0x226b 0x97f4 0x398 0x2376 0x97ad 0x366 0x2481 0x9744 0x348 0x258c 0x96e7 0x334 0x2697 0x9690 0x32a 0x27a2 0x9643 0x32a 0x28ad 0x95ff 0x32a 0x29b8 0x95ba 0x32a 0x2ac3 0x957c 0x334 0x2bce 0x9541 0x33e 0x2cd9 0x950a 0x352 0x2de4 0x94d8 0x352 0x2eef 0x94a6 0x35c 0x2ffa 0x9475 0x366 0x3105 0x944d 0x37a 0x3210 0x9424 0x3de 0x331b 0x93ff 0x38e 0x3426 0x93d7 0x38e 0x3531 0x93b2 0x38e 0x363c 0x9389 0x38e 0x3747 0x935e 0x37a 0x3852 0x9332 0x366 0x395d 0x9307 0x352 0x3a68 0x92d5 0x352 0x3b73 0x929b 0x334 0x3c7e 0x926c 0x334 0x3d89 0x923d 0x33e 0x3e94 0x9209 0x35c 0x3f9f 0x91bb 0x352 0x40aa 0x9161 0x33e 0x41b5 0x911a 0x35c 0x3fac 0x90b7 0x35c 0x4268 0x9057 0x348 0x4330 0x903e 0x352 0x4650 0x9032 0x370 0x4970 0x9022 0x3c0 0x4c90 0x9009 0x3c0 0x4f4c 0x8f68 0x3d4 0x5208 0x8d3a 0x3a2 0x53fc 0x8a08 0x3ca 0x55f0 0x8507 0x3de>;
				battery0_profile_t3_num = <0x64>;
				battery0_profile_t3_col = <0x03>;
				battery0_profile_t3 = <0x00 0xab26 0x2ee 0x10b 0xa946 0x2ee 0x216 0xa7b2 0x2ee 0x321 0xa670 0x2ee 0x42c 0xa504 0x2e4 0x537 0xa39b 0x2f8 0x642 0xa28c 0x2ee 0x74d 0xa1e2 0x2ee 0x858 0xa13e 0x2ee 0x963 0xa032 0x2ee 0xa6e 0x9f8e 0x2f8 0xb79 0x9eed 0x302 0xc84 0x9f17 0x316 0xd8f 0x9e78 0x320 0xe9a 0x9dda 0x32a 0xfa5 0x9d3f 0x334 0x10b0 0x9ca7 0x352 0x11bb 0x9c40 0x35c 0x12c6 0x9bdc 0x370 0x13d1 0x9bab 0x384 0x14dc 0x9b22 0x3ac 0x15e7 0x9acf 0x3ac 0x16f2 0x9a6a 0x3b6 0x17fd 0x9a42 0x3de 0x1908 0x99e8 0x398 0x1a13 0x9984 0x3c0 0x1b1e 0x9958 0x3a2 0x1c29 0x9920 0x3c0 0x1d34 0x98ee 0x398 0x1e3f 0x98bc 0x398 0x1f4a 0x9880 0x3de 0x2055 0x9858 0x38e 0x2160 0x9826 0x398 0x226b 0x97f4 0x398 0x2376 0x97ad 0x366 0x2481 0x9744 0x348 0x258c 0x96e7 0x334 0x2697 0x9690 0x32a 0x27a2 0x9643 0x32a 0x28ad 0x95ff 0x32a 0x29b8 0x95ba 0x32a 0x2ac3 0x957c 0x334 0x2bce 0x9541 0x33e 0x2cd9 0x950a 0x352 0x2de4 0x94d8 0x352 0x2eef 0x94a6 0x35c 0x2ffa 0x9475 0x366 0x3105 0x944d 0x37a 0x3210 0x9424 0x3de 0x331b 0x93ff 0x38e 0x3426 0x93d7 0x38e 0x3531 0x93b2 0x38e 0x363c 0x9389 0x38e 0x3747 0x935e 0x37a 0x3852 0x9332 0x366 0x395d 0x9307 0x352 0x3a68 0x92d5 0x352 0x3b73 0x929b 0x334 0x3c7e 0x926c 0x334 0x3d89 0x923d 0x33e 0x3e94 0x9209 0x35c 0x3f9f 0x91bb 0x352 0x40aa 0x9161 0x33e 0x41b5 0x911a 0x35c 0x3fac 0x90b7 0x35c 0x4268 0x9057 0x348 0x4330 0x903e 0x352 0x4650 0x9032 0x370 0x4970 0x9022 0x3c0 0x4c90 0x9009 0x3c0 0x4f4c 0x8f68 0x3d4 0x5208 0x8d3a 0x3a2 0x53fc 0x8a08 0x3ca 0x55f0 0x8507 0x3de>;
				battery0_profile_t4_num = <0x64>;
				battery0_profile_t4_col = <0x03>;
				battery0_profile_t4 = <0x00 0xab26 0x2ee 0x10b 0xa946 0x2ee 0x216 0xa7b2 0x2ee 0x321 0xa670 0x2ee 0x42c 0xa504 0x2e4 0x537 0xa39b 0x2f8 0x642 0xa28c 0x2ee 0x74d 0xa1e2 0x2ee 0x858 0xa13e 0x2ee 0x963 0xa032 0x2ee 0xa6e 0x9f8e 0x2f8 0xb79 0x9eed 0x302 0xc84 0x9f17 0x316 0xd8f 0x9e78 0x320 0xe9a 0x9dda 0x32a 0xfa5 0x9d3f 0x334 0x10b0 0x9ca7 0x352 0x11bb 0x9c40 0x35c 0x12c6 0x9bdc 0x370 0x13d1 0x9bab 0x384 0x14dc 0x9b22 0x3ac 0x15e7 0x9acf 0x3ac 0x16f2 0x9a6a 0x3b6 0x17fd 0x9a42 0x3de 0x1908 0x99e8 0x398 0x1a13 0x9984 0x3c0 0x1b1e 0x9958 0x3a2 0x1c29 0x9920 0x3c0 0x1d34 0x98ee 0x398 0x1e3f 0x98bc 0x398 0x1f4a 0x9880 0x3de 0x2055 0x9858 0x38e 0x2160 0x9826 0x398 0x226b 0x97f4 0x398 0x2376 0x97ad 0x366 0x2481 0x9744 0x348 0x258c 0x96e7 0x334 0x2697 0x9690 0x32a 0x27a2 0x9643 0x32a 0x28ad 0x95ff 0x32a 0x29b8 0x95ba 0x32a 0x2ac3 0x957c 0x334 0x2bce 0x9541 0x33e 0x2cd9 0x950a 0x352 0x2de4 0x94d8 0x352 0x2eef 0x94a6 0x35c 0x2ffa 0x9475 0x366 0x3105 0x944d 0x37a 0x3210 0x9424 0x3de 0x331b 0x93ff 0x38e 0x3426 0x93d7 0x38e 0x3531 0x93b2 0x38e 0x363c 0x9389 0x38e 0x3747 0x935e 0x37a 0x3852 0x9332 0x366 0x395d 0x9307 0x352 0x3a68 0x92d5 0x352 0x3b73 0x929b 0x334 0x3c7e 0x926c 0x334 0x3d89 0x923d 0x33e 0x3e94 0x9209 0x35c 0x3f9f 0x91bb 0x352 0x40aa 0x9161 0x33e 0x41b5 0x911a 0x35c 0x3fac 0x90b7 0x35c 0x4268 0x9057 0x348 0x4330 0x903e 0x352 0x4650 0x9032 0x370 0x4970 0x9022 0x3c0 0x4c90 0x9009 0x3c0 0x4f4c 0x8f68 0x3d4 0x5208 0x8d3a 0x3a2 0x53fc 0x8a08 0x3ca 0x55f0 0x8507 0x3de>;
				battery0_profile_t5_num = <0x64>;
				battery0_profile_t5_col = <0x03>;
				battery0_profile_t5 = <0x00 0xab26 0x2ee 0x10b 0xa946 0x2ee 0x216 0xa7b2 0x2ee 0x321 0xa670 0x2ee 0x42c 0xa504 0x2e4 0x537 0xa39b 0x2f8 0x642 0xa28c 0x2ee 0x74d 0xa1e2 0x2ee 0x858 0xa13e 0x2ee 0x963 0xa032 0x2ee 0xa6e 0x9f8e 0x2f8 0xb79 0x9eed 0x302 0xc84 0x9f17 0x316 0xd8f 0x9e78 0x320 0xe9a 0x9dda 0x32a 0xfa5 0x9d3f 0x334 0x10b0 0x9ca7 0x352 0x11bb 0x9c40 0x35c 0x12c6 0x9bdc 0x370 0x13d1 0x9bab 0x384 0x14dc 0x9b22 0x3ac 0x15e7 0x9acf 0x3ac 0x16f2 0x9a6a 0x3b6 0x17fd 0x9a42 0x3de 0x1908 0x99e8 0x398 0x1a13 0x9984 0x3c0 0x1b1e 0x9958 0x3a2 0x1c29 0x9920 0x3c0 0x1d34 0x98ee 0x398 0x1e3f 0x98bc 0x398 0x1f4a 0x9880 0x3de 0x2055 0x9858 0x38e 0x2160 0x9826 0x398 0x226b 0x97f4 0x398 0x2376 0x97ad 0x366 0x2481 0x9744 0x348 0x258c 0x96e7 0x334 0x2697 0x9690 0x32a 0x27a2 0x9643 0x32a 0x28ad 0x95ff 0x32a 0x29b8 0x95ba 0x32a 0x2ac3 0x957c 0x334 0x2bce 0x9541 0x33e 0x2cd9 0x950a 0x352 0x2de4 0x94d8 0x352 0x2eef 0x94a6 0x35c 0x2ffa 0x9475 0x366 0x3105 0x944d 0x37a 0x3210 0x9424 0x3de 0x331b 0x93ff 0x38e 0x3426 0x93d7 0x38e 0x3531 0x93b2 0x38e 0x363c 0x9389 0x38e 0x3747 0x935e 0x37a 0x3852 0x9332 0x366 0x395d 0x9307 0x352 0x3a68 0x92d5 0x352 0x3b73 0x929b 0x334 0x3c7e 0x926c 0x334 0x3d89 0x923d 0x33e 0x3e94 0x9209 0x35c 0x3f9f 0x91bb 0x352 0x40aa 0x9161 0x33e 0x41b5 0x911a 0x35c 0x3fac 0x90b7 0x35c 0x4268 0x9057 0x348 0x4330 0x903e 0x352 0x4650 0x9032 0x370 0x4970 0x9022 0x3c0 0x4c90 0x9009 0x3c0 0x4f4c 0x8f68 0x3d4 0x5208 0x8d3a 0x3a2 0x53fc 0x8a08 0x3ca 0x55f0 0x8507 0x3de>;
				phandle = <0x66>;
			};

			mtk_charger_type {
				compatible = "mediatek,mt6357-charger-type";
				io-channels = <0x27 0x02>;
				io-channel-names = "pmic_vbus";
				bc12_active = <0x01>;
				phandle = <0x78>;
			};

			mt6357_charger {
				compatible = "mediatek,mt6357-pulse-charger";
				charger_name = "primary_chg";
				alias_name = "mt6357";
				ichg = <0x7a120>;
				cv = <0x426030>;
				vcdt_hv_thres = <0x6acfc0>;
				vbat_ov_thres = <0x43e6d0>;
				phandle = <0x79>;
			};

			mtk_ts_pmic {
				compatible = "mediatek,mtk_ts_pmic";
				io-channels = <0x27 0x05 0x27 0x06 0x27 0x07>;
				io-channel-names = "pmic_chip_temp", "pmic_buck1_temp", "pmic_buck2_temp";
				interconnects = <0x27 0x01>;
				#interconnect-cells = <0x01>;
				phandle = <0x2d>;
			};

			mt6357_ts_buck1 {
				compatible = "mediatek,mt6357_ts_buck1";
				io-channels = <0x27 0x06>;
				io-channel-names = "pmic_buck1_temp";
				interconnects = <0x2d 0x01>;
				phandle = <0x7a>;
			};

			mt6357_ts_buck2 {
				compatible = "mediatek,mt6357_ts_buck2";
				io-channels = <0x27 0x07>;
				io-channel-names = "pmic_buck2_temp";
				interconnects = <0x2d 0x01>;
				phandle = <0x7b>;
			};

			pmic_efuse {
				compatible = "mediatek,mt6357-efuse";
				#address-cells = <0x01>;
				#size-cells = <0x01>;
				phandle = <0x28>;
			};

			mt6357regulator {
				compatible = "mediatek,mt6357-regulator";
				phandle = <0x7c>;

				buck_vs1 {
					regulator-name = "vs1";
					regulator-min-microvolt = <0x124f80>;
					regulator-max-microvolt = <0x2191c0>;
					regulator-ramp-delay = <0x30d4>;
					regulator-enable-ramp-delay = <0xdc>;
					phandle = <0x7d>;
				};

				buck_vmodem {
					regulator-name = "vmodem";
					regulator-min-microvolt = <0x7a120>;
					regulator-max-microvolt = <0x123716>;
					regulator-ramp-delay = <0x186a>;
					regulator-enable-ramp-delay = <0xdc>;
					phandle = <0x36>;
				};

				buck_vcore {
					regulator-name = "vcore";
					regulator-min-microvolt = <0x7ea5e>;
					regulator-max-microvolt = <0x1406f4>;
					regulator-ramp-delay = <0x186a>;
					regulator-enable-ramp-delay = <0xdc>;
					phandle = <0x37>;
				};

				buck_vproc {
					regulator-name = "vproc";
					regulator-min-microvolt = <0x7ea5e>;
					regulator-max-microvolt = <0x1406f4>;
					regulator-ramp-delay = <0x186a>;
					regulator-enable-ramp-delay = <0xdc>;
					phandle = <0x7e>;
				};

				buck_vpa {
					regulator-name = "vpa";
					regulator-min-microvolt = <0x7a120>;
					regulator-max-microvolt = <0x37b1d0>;
					regulator-ramp-delay = <0xc350>;
					regulator-enable-ramp-delay = <0xdc>;
					phandle = <0x7f>;
				};

				ldo_vfe28 {
					regulator-name = "vfe28";
					regulator-min-microvolt = <0x2ab980>;
					regulator-max-microvolt = <0x2ab980>;
					regulator-enable-ramp-delay = <0x108>;
					phandle = <0x80>;
				};

				ldo_vxo22 {
					regulator-name = "vxo22";
					regulator-min-microvolt = <0x2191c0>;
					regulator-max-microvolt = <0x249f00>;
					regulator-enable-ramp-delay = <0x6e>;
					phandle = <0x81>;
				};

				ldo_vrf18 {
					regulator-name = "vrf18";
					regulator-min-microvolt = <0x1b7740>;
					regulator-max-microvolt = <0x1b7740>;
					regulator-enable-ramp-delay = <0x6e>;
					phandle = <0x82>;
				};

				ldo_vrf12 {
					regulator-name = "vrf12";
					regulator-min-microvolt = <0x124f80>;
					regulator-max-microvolt = <0x124f80>;
					regulator-enable-ramp-delay = <0x6e>;
					phandle = <0x83>;
				};

				ldo_vefuse {
					regulator-name = "vefuse";
					regulator-min-microvolt = <0x124f80>;
					regulator-max-microvolt = <0x325aa0>;
					regulator-enable-ramp-delay = <0x108>;
					phandle = <0x84>;
				};

				ldo_vcn33_bt {
					regulator-name = "vcn33_bt";
					regulator-min-microvolt = <0x325aa0>;
					regulator-max-microvolt = <0x3567e0>;
					regulator-enable-ramp-delay = <0x108>;
					phandle = <0x85>;
				};

				ldo_vcn33_wifi {
					regulator-name = "vcn33_wifi";
					regulator-min-microvolt = <0x325aa0>;
					regulator-max-microvolt = <0x3567e0>;
					regulator-enable-ramp-delay = <0x108>;
					phandle = <0x86>;
				};

				ldo_vcn28 {
					regulator-name = "vcn28";
					regulator-min-microvolt = <0x2ab980>;
					regulator-max-microvolt = <0x2ab980>;
					regulator-enable-ramp-delay = <0x108>;
					phandle = <0x87>;
				};

				ldo_vcn18 {
					regulator-name = "vcn18";
					regulator-min-microvolt = <0x1b7740>;
					regulator-max-microvolt = <0x1b7740>;
					regulator-enable-ramp-delay = <0x108>;
					phandle = <0x88>;
				};

				ldo_vcama {
					status = "okay";
					regulator-default-on = <0x01>;
					regulator-name = "vcama";
					regulator-min-microvolt = <0x2625a0>;
					regulator-max-microvolt = <0x2ab980>;
					regulator-enable-ramp-delay = <0x108>;
					phandle = <0x89>;
				};

				ldo_vcamd {
					status = "okay";
					regulator-default-on = <0x01>;
					regulator-name = "vcamd";
					regulator-min-microvolt = <0xf4240>;
					regulator-max-microvolt = <0x1b7740>;
					regulator-enable-ramp-delay = <0x108>;
					phandle = <0x8a>;
				};

				ldo_vcamio {
					status = "okay";
					regulator-default-on = <0x01>;
					regulator-name = "vcamio";
					regulator-min-microvolt = <0x1b7740>;
					regulator-max-microvolt = <0x1b7740>;
					regulator-enable-ramp-delay = <0x108>;
					phandle = <0x8b>;
				};

				ldo_vldo28 {
					status = "okay";
					regulator-default-on = <0x01>;
					regulator-name = "vldo28";
					regulator-min-microvolt = <0x2ab980>;
					regulator-max-microvolt = <0x2dc6c0>;
					regulator-enable-ramp-delay = <0x108>;
					phandle = <0x8c>;
				};

				ldo_vsram_others {
					regulator-name = "vsram_others";
					regulator-min-microvolt = <0x7ea5e>;
					regulator-max-microvolt = <0x1406f4>;
					regulator-ramp-delay = <0x186a>;
					regulator-enable-ramp-delay = <0x6e>;
					phandle = <0x8d>;
				};

				ldo_vsram_proc {
					regulator-name = "vsram_proc";
					regulator-min-microvolt = <0x7ea5e>;
					regulator-max-microvolt = <0x1406f4>;
					regulator-ramp-delay = <0x186a>;
					regulator-enable-ramp-delay = <0x6e>;
					phandle = <0x8e>;
				};

				ldo_vaux18 {
					regulator-name = "vaux18";
					regulator-min-microvolt = <0x1b7740>;
					regulator-max-microvolt = <0x1b7740>;
					regulator-enable-ramp-delay = <0x108>;
					phandle = <0x8f>;
				};

				ldo_vaud28 {
					regulator-name = "vaud28";
					regulator-min-microvolt = <0x2ab980>;
					regulator-max-microvolt = <0x2ab980>;
					regulator-enable-ramp-delay = <0x108>;
					phandle = <0x90>;
				};

				ldo_vio28 {
					regulator-name = "vio28";
					regulator-min-microvolt = <0x2ab980>;
					regulator-max-microvolt = <0x2ab980>;
					regulator-enable-ramp-delay = <0x108>;
					phandle = <0x91>;
				};

				ldo_vio18 {
					regulator-name = "vio18";
					regulator-min-microvolt = <0x1b7740>;
					regulator-max-microvolt = <0x1b7740>;
					regulator-enable-ramp-delay = <0x108>;
					phandle = <0x92>;
				};

				ldo_vdram {
					regulator-name = "vdram";
					regulator-min-microvolt = <0x10c8e0>;
					regulator-max-microvolt = <0x124f80>;
					regulator-enable-ramp-delay = <0xce4>;
					phandle = <0x93>;
				};

				ldo_vmc {
					regulator-name = "vmc";
					regulator-min-microvolt = <0x1b7740>;
					regulator-max-microvolt = <0x325aa0>;
					regulator-enable-ramp-delay = <0x2c>;
					phandle = <0x5c>;
				};

				ldo_vmch {
					regulator-name = "vmch";
					regulator-min-microvolt = <0x2c4020>;
					regulator-max-microvolt = <0x325aa0>;
					regulator-enable-ramp-delay = <0x2c>;
					phandle = <0x5b>;
				};

				ldo_vemc {
					regulator-name = "vemc";
					regulator-min-microvolt = <0x2c4020>;
					regulator-max-microvolt = <0x325aa0>;
					regulator-enable-ramp-delay = <0x2c>;
					phandle = <0x55>;
				};

				ldo_vsim1 {
					status = "okay";
					regulator-default-on = <0x01>;
					regulator-name = "vsim1";
					regulator-min-microvolt = <0x19f0a0>;
					regulator-max-microvolt = <0x2f4d60>;
					regulator-enable-ramp-delay = <0x108>;
					phandle = <0x94>;
				};

				ldo_vsim2 {
					status = "okay";
					regulator-default-on = <0x01>;
					regulator-name = "vsim2";
					regulator-min-microvolt = <0x19f0a0>;
					regulator-max-microvolt = <0x2f4d60>;
					regulator-enable-ramp-delay = <0x108>;
					phandle = <0x95>;
				};

				ldo_vibr {
					regulator-name = "vibr";
					regulator-min-microvolt = <0x124f80>;
					regulator-max-microvolt = <0x325aa0>;
					regulator-enable-ramp-delay = <0x2c>;
					phandle = <0x02>;
				};

				ldo_vusb33 {
					regulator-name = "vusb33";
					regulator-min-microvolt = <0x2dc6c0>;
					regulator-max-microvolt = <0x2f4d60>;
					regulator-enable-ramp-delay = <0x108>;
					phandle = <0x96>;
				};
			};

			mtk_dynamic_loading_throttling {
				compatible = "mediatek,mt6357-dynamic_loading_throttling";
				mediatek,charger = <0x2e>;
				uvlo-level = <0xa28>;
				isense_support;
				io-channels = <0x27 0x0f 0x27 0x10 0x27 0x01 0x27 0x00>;
				io-channel-names = "pmic_ptim", "pmic_imix_r", "pmic_isense", "pmic_batadc";
			};

			pmic_lbat_service {
				compatible = "mediatek,mt6357-lbat_service";
			};

			mt6357_debug {
				compatible = "mediatek,mt63xx-debug";
			};

			mt63xx-oc-debug {
				compatible = "mediatek,mt63xx-oc-debug";
			};

			leds-mt6357 {
				compatible = "mediatek,mt6357_leds";

				Isink1 {
					reg = <0x01>;
					label = "red";
					linux,default-trigger = "none";
					default-state = "off";
				};
			};

			mtk_rtc {
				compatible = "mediatek,mt6357-rtc";
				#address-cells = <0x01>;
				#size-cells = <0x01>;
				bootmode = <0x2a>;
				phandle = <0x97>;

				fg_init {
					reg = <0x00 0x01>;
					bits = <0x00 0x08>;
					phandle = <0x2b>;
				};

				fg_soc {
					reg = <0x01 0x01>;
					bits = <0x00 0x08>;
					phandle = <0x2c>;
				};

				ext_32k {
					reg = <0x02 0x01>;
					bits = <0x06 0x01>;
					phandle = <0x98>;
				};
			};

			pmic_codec {
				compatible = "mediatek,mt6357-sound";
				mediatek,pwrap-regmap = <0x2f>;
				nvmem = <0x28>;
				nvmem-names = "pmic-hp-efuse";
				io-channels = <0x27 0x0c 0x27 0x09>;
				io-channel-names = "pmic_codec", "pmic_accdet";
				use_hp_depop_flow = <0x00>;
				use_ul_260k = <0x00>;
				phandle = <0x99>;
			};

			clock_buffer_ctrl {
				compatible = "mediatek,clock_buffer";
				n-clkbuf-pmic-dependent = <0x0a>;
				clkbuf-pmic-dependent = "pmic-drvcurr", "pmic-auxout-sel", "pmic-auxout-xo", "pmic-auxout-drvcurr", "pmic-auxout-bblpm-en", "pmic-cofst-fpm", "pmic-cdac-fpm", "pmic-core-idac-fpm", "pmic-aac-fpm-swen", "pmic-heater-sel";
				pmic-dcxo-cw = <0x788>;
				pmic-xo-mode = <0x788 0x00 0x788 0x03 0x788 0x06 0x788 0x09 0xffff 0xffff 0x7a2 0x08 0x7a2 0x0b>;
				pmic-xo-en = <0x788 0x02 0x788 0x05 0x788 0x08 0x788 0x0b 0xffff 0xffff 0x7a2 0x0a 0x7a2 0x0d>;
				pmic-bblpm-sw = <0x788 0x0c>;
				pmic-srclkeni3 = <0x44a 0x00>;
				n-pmic-drvcurr = <0x07>;
				pmic-drvcurr = <0x7b0 0x00 0x7b0 0x02 0x7b0 0x04 0x7b0 0x06 0xffff 0xffff 0x7b0 0x0a 0x7b0 0x0c>;
				n-pmic-auxout-sel = <0x06>;
				pmic-auxout-sel = <0x7b4 0x00 0x7b4 0x05 0x7b4 0x06 0x7b4 0x07 0x7b4 0x06 0x7b4 0x18>;
				n-pmic-auxout-xo = <0x07>;
				pmic-auxout-xo = <0x7b6 0x00 0x7b6 0x06 0x7b6 0x00 0x7b6 0x06 0xffff 0xffff 0x7b6 0x06 0x7b6 0x0c>;
				n-pmic-auxout-drvcurr = <0x07>;
				pmic-auxout-drvcurr = <0x7b6 0x01 0x7b6 0x07 0x7b6 0x01 0x7b6 0x07 0xffff 0xffff 0x7b6 0x01 0x7b6 0x0c>;
				n-pmic-auxout-bblpm-en = <0x01>;
				pmic-auxout-bblpm-en = <0x7b6 0x00>;
				n-pmic-cofst-fpm = <0x01>;
				pmic-cofst-fpm = <0x796 0x0e>;
				n-pmic-cdac-fpm = <0x01>;
				pmic-cdac-fpm = <0x794 0x00>;
				n-pmic-core-idac-fpm = <0x01>;
				pmic-core-idac-fpm = <0x79a 0x0e>;
				n-pmic-aac-fpm-swen = <0x01>;
				pmic-aac-fpm-swen = <0x79e 0x0e>;
				n-pmic-heater-sel = <0x01>;
				pmic-heater-sel = <0x7b8 0x01>;
				phandle = <0x9a>;
			};
		};
	};

	scp@10500000 {
		compatible = "mediatek,scp";
		status = "okay";
		reg = <0x00 0x10500000 0x00 0x40000 0x00 0x105c0000 0x00 0x3000 0x00 0x105c4000 0x00 0x1000 0x00 0x105d4000 0x00 0x6000>;
		interrupts = <0x00 0xc0 0x04>;
		core_1 = "enable";
		scp_sramSize = <0x40000>;
		scp_mpuRegionId = <0x1b>;
		scp_feature_tbl = <0x00 0x2f 0x01 0x164 0x02 0x3e 0x03 0x2f 0x04 0x1a 0x05 0x00 0x06 0xc8 0x07 0x00 0x08 0x64 0x09 0x0a>;
		scp_mem_key = "mediatek,reserve-memory-scp_share";
		scp_mem_tbl = <0x01 0x100000 0x04 0x200000>;
	};

	scp_dvfs {
		compatible = "mediatek,scp_dvfs";
		clocks = <0x26 0x63 0x24 0x26 0x0e 0x26 0x1a 0x26 0x02 0x26 0x17 0x26 0x06 0x26 0x19>;
		clock-names = "clk_mux", "clk_pll_0", "clk_pll_1", "clk_pll_2", "clk_pll_3", "clk_pll_4", "clk_pll_5", "clk_pll_6";
		dvfsrc-opp-num = <0x03>;
		dvfs-opp = <0xff 0xff 0xff 0x00 0x00 0xfa 0x00 0xff 0xff 0xff 0x00 0x00 0x111 0x03 0xff 0xff 0xff 0x02 0x08 0x14a 0x05 0xff 0xff 0xff 0x03 0x0c 0x1a0 0x06>;
		pmic = <0x30>;
		pmic-feature = "pmic-vow-lp", "pmic-pmrc";
		pmic-feature-cfg = <0x00 0x00>;
		gpio = <0x17 0x01>;
		gpio-feature = "gpio-mode";
		gpio-feature-cfg = <0x00>;
	};

	sleep_reg_md@1000f000 {
		compatible = "mediatek,sleep_reg_md";
		reg = <0x00 0x1000f000 0x00 0x1000>;
	};

	kp@10010000 {
		status = "okay";
		mediatek,kpd-hw-factory-key = <0x00>;
		mediatek,kpd-hw-recovery-key = <0x01>;
		mediatek,kpd-hw-dl-key2 = <0x08>;
		mediatek,kpd-hw-dl-key1 = <0x00>;
		mediatek,kpd-hw-dl-key0 = <0x01>;
		mediatek,kpd-pwkey-gpio-din = <0x00>;
		mediatek,kpd-pwrkey-eint-gpio = <0x00>;
		mediatek,kpd-hw-init-map = <0x72 0x73 0x00 0x20b 0x00 0x00 0x00 0x00 0x00 0x00 0x00 0x00 0x00 0x00 0x00 0x00 0x00 0x00 0x00 0xd4 0x64 0x38 0x00 0x00 0x00 0x00 0x00 0x00 0x00 0x00 0x00 0x00 0x00 0x00 0x00 0x00 0x00 0x00 0x00 0x00 0x00 0x00 0x00 0x00 0x00 0x00 0x00 0x00 0x00 0x00 0x00 0x00 0x00 0x00 0x00 0x00 0x00 0x00 0x00 0x00 0x00 0x00 0x00 0x00 0x00 0x00 0x00 0x00 0x00 0x00 0x00 0x00>;
		mediatek,kpd-hw-map-num = <0x48>;
		mediatek,kpd-use-extend-type = <0x00>;
		mediatek,kpd-hw-rstkey = <0x11>;
		mediatek,kpd-sw-rstkey = <0x66>;
		mediatek,kpd-hw-pwrkey = <0x08>;
		mediatek,kpd-sw-pwrkey = <0x74>;
		mediatek,kpd-key-debounce = <0x400>;
		pinctrl-0 = <0x10e>;
		pinctrl-names = "default";
		compatible = "mediatek,kp";
		reg = <0x00 0x10010000 0x00 0x1000>;
		interrupts = <0x00 0xb4 0x02>;
		clocks = <0x24>;
		clock-names = "kpd";
		phandle = <0x20>;
	};

	otg_iddig {
		compatible = "mediatek,usb_iddig_bi_eint";
		phandle = <0x9b>;
	};

	mrdump_ext_rst {
		debounce = <0x7d000>;
		deb-gpios = <0x1f 0x02 0x00>;
		interrupts = <0x02 0x08 0x02 0x00>;
		interrupt-parent = <0x1f>;
		compatible = "mediatek, mrdump_ext_rst-eint";
		force_mode = "EINT";
		mode = "IRQ";
		status = "okay";
		phandle = <0x9c>;
	};

	touch {
		vtouch-supply = <0x8c>;
		interrupts = <0x00 0x02 0x00 0x00>;
		interrupt-parent = <0x1f>;
		status = "okay";
		pinctrl-5 = <0x109>;
		pinctrl-4 = <0x108>;
		pinctrl-3 = <0x107>;
		pinctrl-2 = <0x106>;
		pinctrl-1 = <0x105>;
		pinctrl-0 = <0x104>;
		pinctrl-names = "default", "state_eint_as_int", "state_eint_output0", "state_eint_output1", "state_rst_output0", "state_rst_output1";
		tpd-filter-custom-speed = <0x00 0x00 0x00>;
		tpd-filter-custom-prameters = <0x00 0x00 0x00 0x00 0x00 0x00 0x00 0x00 0x00 0x00 0x00 0x00>;
		tpd-filter-pixel-density = <0x92>;
		tpd-filter-enable = <0x01>;
		tpd-max-touch-num = <0x05>;
		tpd-key-dim-local = <0x5a 0x373 0x64 0x28 0xe6 0x373 0x64 0x28 0x172 0x373 0x64 0x28 0x00 0x00 0x00 0x00>;
		tpd-key-local = <0x8b 0xac 0x9e 0x00>;
		tpd-key-num = <0x03>;
		use-tpd-button = <0x00>;
		tpd-resolution = <0x438 0x780>;
		compatible = "goodix,touch";
		phandle = <0x9d>;
	};

	accdet {
		compatible = "mediatek,pmic-accdet";
		phandle = <0x9e>;
	};

	fingerprint {
		status = "okay";
		pinctrl-2 = <0x115>;
		pinctrl-1 = <0x114>;
		pinctrl-0 = <0x113>;
		pinctrl-names = "default", "reset_high", "reset_low";
		compatible = "mediatek,goodix-fp";
		phandle = <0x9f>;
	};

	microarray_finger {
		compatible = "mediatek,microarray_finger";
		phandle = <0xa0>;
	};

	silead_spi@ {
		compatible = "mediatek,spidev-pins";
		phandle = <0xa1>;
	};

	silead_fp@ {
		compatible = "sil,silead_fp-pins";
		phandle = <0xa2>;
	};

	writing {
		compatible = "mediatek,hand-writing";
		phandle = <0xa3>;
	};

	topmisc@10011000 {
		compatible = "mediatek,topmisc";
		reg = <0x00 0x10011000 0x00 0x1000>;
	};

	dvfsrc@10012000 {
		compatible = "mediatek,mt6765-dvfsrc";
		reg = <0x00 0x10012000 0x00 0x1000 0x00 0x10006000 0x00 0x1000>;
		reg-names = "dvfsrc", "spm";
		#address-cells = <0x02>;
		#size-cells = <0x02>;
		ranges;
		phandle = <0xa4>;

		opp2 {
			opp-level = <0x02>;
			phandle = <0x33>;
		};

		opp1 {
			opp-level = <0x01>;
			phandle = <0x32>;
		};

		opp0 {
			opp-level = <0x00>;
			phandle = <0x31>;
		};

		dvfsrc-up {
			compatible = "mediatek,mt6765-dvfsrc-up";
		};

		dvfsrc-debug {
			compatible = "mediatek,mt6765-dvfsrc-debug";
			required-opps = <0x31 0x32 0x33>;
		};

		dvfsrc-met {
			compatible = "mediatek,mt6765-dvfsrc-met";
		};

		qos@00110b80 {
			compatible = "mediatek,mt6765-qos";
			reg = <0x00 0x110b80 0x00 0x80>;
		};
	};

	mbist_ao@10013000 {
		compatible = "mediatek,mbist_ao";
		reg = <0x00 0x10013000 0x00 0x1000>;
	};

	apcldmain_ao@10014000 {
		compatible = "mediatek,apcldmain_ao";
		reg = <0x00 0x10014000 0x00 0x400>;
	};

	apcldmaout_ao@10014400 {
		compatible = "mediatek,apcldmaout_ao";
		reg = <0x00 0x10014400 0x00 0x400>;
	};

	apcldmamisc_ao@10014800 {
		compatible = "mediatek,apcldmamisc_ao";
		reg = <0x00 0x10014800 0x00 0x400>;
	};

	ddrphy@10015000 {
		compatible = "mediatek,ddrphy";
		reg = <0x00 0x10015000 0x00 0x1000>;
	};

	aes_top0@10016000 {
		compatible = "mediatek,aes_top0";
		reg = <0x00 0x10016000 0x00 0x1000>;
	};

	timer@10017000 {
		compatible = "mediatek,sys_timer", "mediatek,mt6761-timer", "mediatek,mt6765-timer";
		reg = <0x00 0x10017000 0x00 0x1000>;
		reg-names = "sys_timer_base";
		interrupts = <0x00 0xc2 0x04>;
		clocks = <0x34>;
		phandle = <0xa5>;
	};

	modem_temp_share@10018000 {
		compatible = "mediatek,modem_temp_share";
		reg = <0x00 0x10018000 0x00 0x1000>;
	};

	security_ao@1001a000 {
		compatible = "mediatek,security_ao";
		reg = <0x00 0x1001a000 0x00 0x1000>;
	};

	topckgen_ao@1001b000 {
		compatible = "mediatek,topckgen_ao";
		reg = <0x00 0x1001b000 0x00 0x1000>;
	};

	dramc0@1001d000 {
		compatible = "mediatek,dramc0";
		reg = <0x00 0x1001d000 0x00 0x1000>;
	};

	ddrphy@1001e000 {
		compatible = "mediatek,ddrphy";
		reg = <0x00 0x1001e000 0x00 0x1000>;
	};

	mdcldmain_ao@10015000 {
		compatible = "mediatek,mdcldmain_ao";
		reg = <0x00 0x10015000 0x00 0x400>;
	};

	mdcldmaout_ao@10015400 {
		compatible = "mediatek,mdcldmaout_ao";
		reg = <0x00 0x10015400 0x00 0x400>;
	};

	mdcldmamisc_ao@10015800 {
		compatible = "mediatek,mdcldmamisc_ao";
		reg = <0x00 0x10015800 0x00 0x400>;
	};

	sys_cirq@10204000 {
		compatible = "mediatek,sys_cirq";
		reg = <0x00 0x10204000 0x00 0x1000>;
		mediatek,cirq_num = <0xd1>;
		mediatek,spi_start_offset = <0x48>;
		interrupts = <0x00 0x118 0x08>;
	};

	mcucfg@10200000 {
		compatible = "mediatek,mcucfg";
		reg = <0x00 0x10200000 0x00 0x1000>;
		interrupts = <0x00 0x00 0x08>;
	};

	mcucfg_mp0_counter@10200000 {
		compatible = "mediatek,mcucfg_mp0_counter";
		reg = <0x00 0x10200000 0x00 0x4000>;
	};

	m4u@10205000 {
		cell-index = <0x00>;
		compatible = "mediatek,m4u";
		reg = <0x00 0x10205000 0x00 0x1000>;
		interrupts = <0x00 0x9e 0x08>;
	};

	devapc@10207000 {
		compatible = "mediatek,devapc";
		reg = <0x00 0x10207000 0x00 0x1000>;
		interrupts = <0x00 0x8e 0x08>;
		clocks = <0x25 0x28>;
		clock-names = "devapc-infra-clock";
	};

	bus_dbg@10208000 {
		compatible = "mediatek,bus_dbg-v2";
		reg = <0x00 0x10208000 0x00 0x1000 0x00 0x10001000 0x00 0x1000>;
		mediatek,bus_dbg_con_offset = <0x2fc>;
		interrupts = <0x00 0x8d 0x08>;
	};

	ap_ccif0@10209000 {
		compatible = "mediatek,ap_ccif0";
		reg = <0x00 0x10209000 0x00 0x1000>;
		interrupts = <0x00 0x94 0x08>;
	};

	md_ccif0@1020a000 {
		compatible = "mediatek,md_ccif0";
		reg = <0x00 0x1020a000 0x00 0x1000>;
	};

	ap_ccif1@1020b000 {
		compatible = "mediatek,ap_ccif1";
		reg = <0x00 0x1020b000 0x00 0x1000>;
		interrupts = <0x00 0x96 0x08>;
	};

	md_ccif1@1020c000 {
		compatible = "mediatek,md_ccif1";
		reg = <0x00 0x1020c000 0x00 0x1000>;
	};

	infra_mbist@1020d000 {
		compatible = "mediatek,infra_mbist";
		reg = <0x00 0x1020d000 0x00 0x1000>;
	};

	infracfg@1020e000 {
		compatible = "mediatek,infracfg";
		reg = <0x00 0x1020e000 0x00 0x1000>;
	};

	trng@1020f000 {
		compatible = "mediatek,trng";
		reg = <0x00 0x1020f000 0x00 0x1000>;
		interrupts = <0x00 0xa1 0x08>;
	};

	dxcc_sec@10210000 {
		compatible = "mediatek,dxcc_sec";
		reg = <0x00 0x10210000 0x00 0x1000>;
		interrupts = <0x00 0xa2 0x04>;
	};

	mcupm_sram2@10211000 {
		compatible = "mediatek,mcupm_sram2";
		reg = <0x00 0x10211000 0x00 0x1000>;
	};

	cq_dma@10212000 {
		compatible = "mediatek,mt-cqdma-v1";
		reg = <0x00 0x10212000 0x00 0x80 0x00 0x10212080 0x00 0x80>;
		interrupts = <0x00 0x71 0x08 0x00 0x72 0x08>;
		nr_channel = <0x02>;
		keep_clock_ao = "yes";
		clocks = <0x25 0x43>;
		clock-names = "cqdma";
	};

	mcupm_sram3@10213000 {
		compatible = "mediatek,mcupm_sram3";
		reg = <0x00 0x10213000 0x00 0x1000>;
	};

	sramrom@10214000 {
		compatible = "mediatek,sramrom";
		reg = <0x00 0x10214000 0x00 0x1000>;
	};

	mcupm_reg@10216000 {
		compatible = "mediatek,mcupm_reg";
		reg = <0x00 0x10216000 0x00 0x1000>;
	};

	mcupm_sram0@10217000 {
		compatible = "mediatek,mcupm_sram0";
		reg = <0x00 0x10217000 0x00 0x1000>;
	};

	mcupm_sram1@10218000 {
		compatible = "mediatek,mcupm_sram1";
		reg = <0x00 0x10218000 0x00 0x1000>;
	};

	emi@10219000 {
		compatible = "mediatek,emi";
		reg = <0x00 0x10219000 0x00 0x1000 0x00 0x10226000 0x00 0x1000 0x00 0x1022d000 0x00 0x1000 0x00 0x10235000 0x00 0x1000>;
		interrupts = <0x00 0x90 0x08>;
	};

	apcldmain@1021b000 {
		compatible = "mediatek,apcldmain";
		reg = <0x00 0x1021b000 0x00 0x00>;
	};

	apcldmaout@1021b400 {
		compatible = "mediatek,apcldmaout";
		reg = <0x00 0x1021b400 0x00 0x00>;
	};

	apcldmamisc@1021b800 {
		compatible = "mediatek,apcldmamisc";
		reg = <0x00 0x1021b800 0x00 0x00>;
		interrupts = <0x00 0xa5 0x04>;
	};

	mdcldmain@1021c000 {
		compatible = "mediatek,mdcldmain";
		reg = <0x00 0x1021c000 0x00 0x400>;
	};

	mdcldmaout@1021c400 {
		compatible = "mediatek,mdcldmaout";
		reg = <0x00 0x1021c400 0x00 0x400>;
	};

	mdcldmamisc@1021c800 {
		compatible = "mediatek,mdcldmamisc";
		reg = <0x00 0x1021c800 0x00 0x1000>;
	};

	ccifdriver@10209000 {
		compatible = "mediatek,ccci_ccif";
		reg = <0x00 0x10209000 0x00 0x1000 0x00 0x1020a000 0x00 0x1000>;
		mediatek,sram_size = <0x200>;
		interrupts = <0x00 0x94 0x08 0x00 0x95 0x08>;
		clocks = <0x25 0x29 0x25 0x2c 0x25 0x23 0x25 0x24 0x25 0x51 0x25 0x52>;
		clock-names = "infra-ccif-ap", "infra-ccif-md", "infra-ccif1-ap", "infra-ccif1-md", "infra-ccif2-ap", "infra-ccif2-md";
		phandle = <0xa6>;
	};

	cldmadriver@10014000 {
		compatible = "mediatek,ccci_cldma";
		reg = <0x00 0x10014000 0x00 0x1000 0x00 0x1021b000 0x00 0x1000>;
		interrupts = <0x00 0xa5 0x04>;
		mediatek,cldma_capability = <0x06>;
		mediatek,md_generation = <0x1895>;
		mediatek,platform = <0x1a6d>;
		clocks = <0x25 0x32>;
		clock-names = "infra-cldma-bclk";
		cldma-infracfg = <0x25>;
		phandle = <0xa7>;
	};

	mddriver@10014000 {
		compatible = "mediatek,mddriver", "mediatek,mddriver-mt6765";
		reg = <0x00 0x10014000 0x00 0x1000 0x00 0x1021b000 0x00 0x1000 0x00 0x10209000 0x00 0x1000 0x00 0x1020a000 0x00 0x1000>;
		interrupts = <0x00 0xa5 0x04 0x00 0x94 0x08 0x00 0x95 0x08 0x00 0x105 0x02>;
		mediatek,mdhif_type = <0x03>;
		mediatek,md_id = <0x00>;
		mediatek,ap_plat_info = <0x1a6d>;
		mediatek,md_generation = <0x1895>;
		mediatek,offset_apon_md1 = <0x1c24>;
		mediatek,cldma_capability = <0x06>;
		clocks = <0x35 0x00 0x25 0x32 0x25 0x29 0x25 0x2c 0x25 0x23 0x25 0x24 0x25 0x51 0x25 0x52>;
		clock-names = "scp-sys-md1-main", "infra-cldma-bclk", "infra-ccif-ap", "infra-ccif-md", "infra-ccif1-ap", "infra-ccif1-md", "infra-ccif2-ap", "infra-ccif2-md";
		_vmodem-supply = <0x36>;
		_vcore-supply = <0x37>;
		ccci-infracfg = <0x25>;
		phandle = <0x22>;
	};

	md_auxadc {
		compatible = "mediatek,md_auxadc";
		io-channels = <0x38 0x02>;
		io-channel-names = "md-channel", "md-battery";
		phandle = <0xa8>;
	};

	dramc_nao@1021d000 {
		compatible = "mediatek,dramc_nao";
		reg = <0x00 0x1021d000 0x00 0x1000>;
	};

	bpi_bsi_slv0@1021e000 {
		compatible = "mediatek,bpi_bsi_slv0";
		reg = <0x00 0x1021e000 0x00 0x1000>;
	};

	bpi_bsi_slv1@1021f000 {
		compatible = "mediatek,bpi_bsi_slv1";
		reg = <0x00 0x1021f000 0x00 0x6000>;
	};

	bpi_bsi_slv2@10225000 {
		compatible = "mediatek,bpi_bsi_slv2";
		reg = <0x00 0x10225000 0x00 0x1000>;
	};

	dvfsp@10227000 {
		compatible = "mediatek,dvfsp";
		reg = <0x00 0x10227000 0x00 0x1000>;
	};

	dvfsp@00110c00 {
		compatible = "mediatek,mt6765-dvfsp";
		reg = <0x00 0x110c00 0x00 0x1400 0x00 0x110c00 0x00 0x1400>;
		state = <0x01>;
		change_flag = <0x00>;
		little-rise-time = <0x3e8>;
		little-down-time = <0x2ee>;
		big-rise-time = <0x3e8>;
		big-down-time = <0x2ee>;
		nvmem-cells = <0x39 0x3a>;
		nvmem-cell-names = "efuse_segment_cell", "efuse_ly_cell";
		L-table = <0x7d0 0x60 0x01 0x01 0x78d 0x5c 0x01 0x01 0x74a 0x58 0x01 0x01 0x708 0x53 0x01 0x01 0x6c5 0x50 0x01 0x01 0x682 0x4b 0x01 0x01 0x60c 0x47 0x01 0x01 0x5c3 0x42 0x02 0x01 0x55f 0x40 0x02 0x01 0x4fb 0x3a 0x02 0x01 0x497 0x36 0x02 0x01 0x433 0x31 0x02 0x01 0x3e7 0x2e 0x02 0x01 0x39d 0x2b 0x02 0x01 0x352 0x28 0x02 0x01 0x306 0x26 0x02 0x01>;
		B-table = <0x898 0x64 0x01 0x01 0x855 0x60 0x01 0x01 0x812 0x5c 0x01 0x01 0x7d0 0x58 0x01 0x01 0x78d 0x54 0x01 0x01 0x74a 0x50 0x01 0x01 0x708 0x4b 0x01 0x01 0x673 0x46 0x01 0x01 0x5df 0x40 0x01 0x01 0x586 0x3d 0x02 0x01 0x50f 0x39 0x02 0x01 0x498 0x35 0x02 0x01 0x43f 0x31 0x02 0x01 0x3e6 0x2e 0x02 0x01 0x38d 0x2b 0x02 0x01 0x352 0x28 0x02 0x01>;
		CCI-table = <0x578 0x60 0x02 0x01 0x549 0x5c 0x02 0x01 0x51a 0x58 0x02 0x01 0x4ec 0x54 0x02 0x01 0x4a6 0x4e 0x02 0x01 0x483 0x4b 0x02 0x01 0x460 0x47 0x02 0x01 0x3d8 0x40 0x02 0x01 0x395 0x3e 0x02 0x01 0x33b 0x3a 0x02 0x01 0x2e1 0x36 0x02 0x02 0x29d 0x33 0x02 0x02 0x243 0x2f 0x02 0x02 0x200 0x2c 0x02 0x02 0x1bd 0x29 0x02 0x02 0x190 0x26 0x02 0x02>;
	};

	eem_fsm@1100b000 {
		compatible = "mediatek,eem_fsm";
		reg = <0x00 0x1100b000 0x00 0x1000>;
		interrupts = <0x00 0x7d 0x08>;
		nvmem = <0x3b>;
		nvmem-names = "mtk_efuse";
		nvmem-cells = <0x39>;
		nvmem-cell-names = "efuse_segment_cell";
	};

	dramc@1022a000 {
		compatible = "mediatek,dramc";
		reg = <0x00 0x1022a000 0x00 0x2000 0x00 0x10232000 0x00 0x2000 0x00 0x1022c000 0x00 0x1000 0x00 0x10234000 0x00 0x1000 0x00 0x10228000 0x00 0x2000 0x00 0x10230000 0x00 0x2000 0x00 0x1022e000 0x00 0x1000 0x00 0x10236000 0x00 0x1000>;
	};

	gce@10238000 {
		compatible = "mediatek,gce", "syscon";
		reg = <0x00 0x10238000 0x00 0x4000>;
		interrupts = <0x00 0x9a 0x08 0x00 0x9b 0x08>;
		g3d_config_base = <0x13000000 0x00 0xffff0000>;
		mmsys_config_base = <0x14000000 0x01 0xffff0000>;
		disp_dither_base = <0x14010000 0x02 0xffff0000>;
		mm_na_base = <0x14020000 0x03 0xffff0000>;
		imgsys_base = <0x15020000 0x04 0xffff0000>;
		vdec_gcon_base = <0x18800000 0x05 0xffff0000>;
		venc_gcon_base = <0x18810000 0x06 0xffff0000>;
		conn_peri_base = <0x18820000 0x07 0xffff0000>;
		topckgen_base = <0x18830000 0x08 0xffff0000>;
		kp_base = <0x18840000 0x09 0xffff0000>;
		scp_sram_base = <0x10000000 0x0a 0xffff0000>;
		infra_na3_base = <0x10010000 0x0b 0xffff0000>;
		infra_na4_base = <0x10020000 0x0c 0xffff0000>;
		scp_base = <0x10030000 0x0d 0xffff0000>;
		mcucfg_base = <0x10040000 0x0e 0xffff0000>;
		gcpu_base = <0x10050000 0x0f 0xffff0000>;
		usb0_base = <0x10200000 0x10 0xffff0000>;
		usb_sif_base = <0x10280000 0x11 0xffff0000>;
		audio_base = <0x17000000 0x12 0xffff0000>;
		vdec_base = <0x17010000 0x13 0xffff0000>;
		msdc2_base = <0x17020000 0x14 0xffff0000>;
		vdec1_base = <0x17030000 0x15 0xffff0000>;
		msdc3_base = <0x18000000 0x16 0xffff0000>;
		ap_dma_base = <0x18010000 0x17 0xffff0000>;
		gce_base = <0x18020000 0x18 0xffff0000>;
		vdec2_base = <0x18040000 0x19 0xffff0000>;
		vdec3_base = <0x18050000 0x1a 0xffff0000>;
		camsys_base = <0x18080000 0x1b 0xffff0000>;
		camsys1_base = <0x180a0000 0x1c 0xffff0000>;
		camsys2_base = <0x180b0000 0x1d 0xffff0000>;
		pwm_sw_base = <0x1100e000 0x63 0xffff0000>;
		mipitx0_base = <0x11c80000 0x63 0xffff0000>;
		mdp_rdma0_sof = <0x00>;
		mdp_ccorr0_sof = <0x01>;
		mdp_rsz0_sof = <0x02>;
		mdp_rsz1_sof = <0x03>;
		mdp_wdma_sof = <0x04>;
		mdp_wrot0_sof = <0x05>;
		mdp_tdshp0_sof = <0x06>;
		disp_ovl0_sof = <0x07>;
		disp_2l_ovl0_sof = <0x08>;
		disp_rdma0_sof = <0x09>;
		disp_wdma0_sof = <0x0a>;
		disp_color0_sof = <0x0b>;
		disp_ccorr0_sof = <0x0c>;
		disp_aal0_sof = <0x0d>;
		disp_gamma0_sof = <0x0e>;
		disp_dither0_sof = <0x0f>;
		disp_dsi0_sof = <0x10>;
		disp_rsz0_sof = <0x11>;
		img_dl_relay_sof = <0x12>;
		disp_pwm0_sof = <0x13>;
		mdp_rdma0_frame_done = <0x14>;
		mdp_ccorr0_frame_done = <0x15>;
		mdp_rsz0_frame_done = <0x16>;
		mdp_rsz1_frame_done = <0x17>;
		mdp_wrot0_write_frame_done = <0x18>;
		mdp_wdma_frame_done = <0x19>;
		mdp_tdshp0_frame_done = <0x1a>;
		disp_ovl0_frame_done = <0x1b>;
		disp_2l_ovl0_frame_done = <0x1c>;
		disp_rsz0_frame_done = <0x1d>;
		disp_rdma0_frame_done = <0x1e>;
		disp_wdma0_frame_done = <0x1f>;
		disp_color0_frame_done = <0x20>;
		disp_ccorr0_frame_done = <0x21>;
		disp_aal0_frame_done = <0x22>;
		disp_gamma0_frame_done = <0x23>;
		disp_dither0_frame_done = <0x24>;
		disp_dsi0_frame_done = <0x25>;
		stream_done_0 = <0x82>;
		stream_done_1 = <0x83>;
		stream_done_2 = <0x84>;
		stream_done_3 = <0x85>;
		stream_done_4 = <0x86>;
		stream_done_5 = <0x87>;
		stream_done_6 = <0x88>;
		stream_done_7 = <0x89>;
		stream_done_8 = <0x8a>;
		stream_done_9 = <0x8b>;
		buf_underrun_event_0 = <0x8c>;
		dsi0_te_event = <0x8d>;
		dsi0_irq_event = <0x8e>;
		dsi0_done_event = <0x8f>;
		disp_wdma0_rst_done = <0x93>;
		mdp_wdma_rst_done = <0x94>;
		mdp_wrot0_rst_done = <0x95>;
		mdp_rdma0_rst_done = <0x97>;
		disp_ovl0_frame_rst_done_pusle = <0x98>;
		dip_cq_thread0_frame_done = <0x101>;
		dip_cq_thread1_frame_done = <0x102>;
		dip_cq_thread2_frame_done = <0x103>;
		dip_cq_thread3_frame_done = <0x104>;
		dip_cq_thread4_frame_done = <0x105>;
		dip_cq_thread5_frame_done = <0x106>;
		dip_cq_thread6_frame_done = <0x107>;
		dip_cq_thread7_frame_done = <0x108>;
		dip_cq_thread8_frame_done = <0x109>;
		dip_cq_thread9_frame_done = <0x10a>;
		dip_cq_thread10_frame_done = <0x10b>;
		dip_cq_thread11_frame_done = <0x10c>;
		dip_cq_thread12_frame_done = <0x10d>;
		dip_cq_thread13_frame_done = <0x10e>;
		dip_cq_thread14_frame_done = <0x10f>;
		dip_cq_thread15_frame_done = <0x110>;
		dip_cq_thread16_frame_done = <0x111>;
		dip_cq_thread17_frame_done = <0x112>;
		dip_cq_thread18_frame_done = <0x113>;
		dve_frame_done = <0x114>;
		wmf_frame_done = <0x115>;
		rsc_frame_done = <0x116>;
		venc_done = <0x121>;
		jpgenc_done = <0x122>;
		jpgdec_done = <0x123>;
		venc_mb_done = <0x124>;
		venc_128byte_cnt_done = <0x125>;
		max_prefetch_cnt = <0x01>;
		prefetch_size = <0x60>;
		sram_size_cpr_64 = <0x40>;
		mmsys_config = <0x3c>;
		mdp_rdma0 = <0x3d>;
		mdp_rsz0 = <0x3e>;
		mdp_rsz1 = <0x3f>;
		mdp_wdma0 = <0x40>;
		mdp_wrot0 = <0x41>;
		mdp_tdshp0 = <0x42>;
		mdp_color0 = <0x43>;
		mdp_ccorr0 = <0x44>;
		mm_mutex = <0x45>;
		sram_share_cnt = <0x01>;
		sram_share_engine = <0x0a>;
		sram_share_event = <0x2c6>;
		clocks = <0x25 0x09 0x25 0x18>;
		clock-names = "GCE", "GCE_TIMER";
		mediatek,mailbox-gce = <0x46>;
		mboxes = <0x46 0x00 0x00 0x04 0x46 0x01 0x00 0x04 0x46 0x02 0x00 0x05 0x46 0x03 0x00 0x04 0x46 0x04 0x00 0x04 0x46 0x05 0x00 0x04 0x46 0x06 0x00 0x04 0x46 0x07 0xffffffff 0x02 0x47 0x08 0x00 0x04 0x47 0x09 0x00 0x04 0x47 0x0a 0x00 0x01 0x46 0x0b 0x00 0x01 0x46 0x0c 0x00 0x01 0x46 0x0d 0x00 0x01 0x46 0x0e 0x00 0x01 0x46 0x0f 0xffffffff 0x01>;
		phandle = <0xa9>;
	};

	gce_mbox@10238000 {
		compatible = "mediatek,mt6761-gce";
		reg = <0x00 0x10238000 0x00 0x4000>;
		interrupts = <0x00 0x9a 0x08 0x00 0x9b 0x08>;
		#mbox-cells = <0x03>;
		#gce-event-cells = <0x01>;
		#gce-subsys-cells = <0x02>;
		default_tokens = [02 bc 02 bd 02 be 02 bf 02 c0 02 c6 02 c7];
		clocks = <0x25 0x09 0x25 0x18>;
		clock-names = "gce", "gce-timer";
		phandle = <0x46>;
	};

	gce_mbox_svp@10238000 {
		compatible = "mediatek,mailbox-gce-svp";
		reg = <0x00 0x10238000 0x00 0x4000>;
		interrupts = <0x00 0x9a 0x08 0x00 0x9b 0x08>;
		#mbox-cells = <0x03>;
		clocks = <0x25 0x09 0x25 0x18>;
		clock-names = "gce", "GCE_TIMER";
		phandle = <0x47>;
	};

	ap_ccif2@1023c000 {
		compatible = "mediatek,ap_ccif2";
		reg = <0x00 0x1023c000 0x00 0x1000>;
		interrupts = <0x00 0x8f 0x08>;
	};

	md_ccif2@1023d000 {
		compatible = "mediatek,md_ccif2";
		reg = <0x00 0x1023d000 0x00 0x1000>;
	};

	ap_ccif3@1023e000 {
		compatible = "mediatek,ap_ccif3";
		reg = <0x00 0x1023e000 0x00 0x1000>;
		interrupts = <0x00 0x92 0x08>;
	};

	md_ccif3@1023f000 {
		compatible = "mediatek,md_ccif3";
		reg = <0x00 0x1023f000 0x00 0x1000>;
	};

	sspm@10440000 {
		compatible = "mediatek,mt6765-sspm";
		reg = <0x00 0x10440000 0x00 0x10000 0x00 0x10450000 0x00 0x100 0x00 0x10451000 0x00 0x08 0x00 0x10460000 0x00 0x100 0x00 0x10461000 0x00 0x08 0x00 0x10470000 0x00 0x100 0x00 0x10471000 0x00 0x08 0x00 0x10480000 0x00 0x100 0x00 0x10481000 0x00 0x08 0x00 0x10490000 0x00 0x100 0x00 0x10491000 0x00 0x08>;
		reg-names = "cfgreg", "mbox0_base", "mbox0_ctrl", "mbox1_base", "mbox1_ctrl", "mbox2_base", "mbox2_ctrl", "mbox3_base", "mbox3_ctrl", "mbox4_base", "mbox4_ctrl";
		interrupts = <0x00 0xca 0x04 0x00 0xcd 0x04 0x00 0xce 0x04 0x00 0xcf 0x04 0x00 0xd0 0x04 0x00 0xd1 0x04>;
		interrupt-names = "ipc", "mbox0", "mbox1", "mbox2", "mbox3", "mbox4";
	};

	gic500@0c000000 {
		compatible = "mediatek,gic500";
		reg = <0x00 0xc000000 0x00 0x1000>;
	};

	gic_cpu@0c400000 {
		compatible = "mediatek,gic_cpu";
		reg = <0x00 0xc400000 0x00 0x40000>;
	};

	dfd@10200b00 {
		compatible = "mediatek,dfd";
		reg = <0x00 0x10200b00 0x00 0x10000>;
		mediatek,enabled = <0x01>;
		mediatek,chain_length = <0xc350>;
		mediatek,rg_dfd_timeout = <0xa0>;
		mediatek,check_dfd_support = <0x01>;
		mediatek,dfd_infra_base = <0x390>;
		mediatek,dfd_ap_addr_offset = <0x18>;
		mediatek,dfd_latch_offset = <0x48>;
		reg_base = <0x48>;
	};

	dbg_cti@0d020000 {
		compatible = "mediatek,dbg_cti";
		reg = <0x00 0xd020000 0x00 0x10000>;
	};

	dbg_etr@0d030000 {
		compatible = "mediatek,dbg_etr";
		reg = <0x00 0xd030000 0x00 0x10000>;
	};

	dbg_funnel@0d040000 {
		compatible = "mediatek,dbg_funnel";
		reg = <0x00 0xd040000 0x00 0x10000>;
	};

	dbg_dem@0d0a0000 {
		compatible = "mediatek,dbg_dem";
		reg = <0x00 0xd0a0000 0x00 0x10000>;
		interrupts = <0x00 0x8c 0x08>;
	};

	dbg_mdsys1@0d0c0000 {
		compatible = "mediatek,dbg_mdsys1";
		reg = <0x00 0xd0c0000 0x00 0x40000>;
	};

	dbg_apmcu_mp0@0d400000 {
		compatible = "mediatek,dbg_apmcu_mp0";
		reg = <0x00 0xd400000 0x00 0x1000>;
	};

	dbg_apmcu_mp0@0d410000 {
		compatible = "mediatek,dbg_apmcu_mp0";
		reg = <0x00 0xd410000 0x00 0x1000>;
	};

	dbg_apmcu_mp0@0d420000 {
		compatible = "mediatek,dbg_apmcu_mp0";
		reg = <0x00 0xd420000 0x00 0x1000>;
	};

	dbg_apmcu_mp0@0d430000 {
		compatible = "mediatek,dbg_apmcu_mp0";
		reg = <0x00 0xd430000 0x00 0x1000>;
	};

	dbg_apmcu_mp0@0d440000 {
		compatible = "mediatek,dbg_apmcu_mp0";
		reg = <0x00 0xd440000 0x00 0x1000>;
	};

	dbg_apmcu_mp0@0d510000 {
		compatible = "mediatek,dbg_apmcu_mp0";
		reg = <0x00 0xd510000 0x00 0x1000>;
	};

	dbg_apmcu_mp0@0d520000 {
		compatible = "mediatek,dbg_apmcu_mp0";
		reg = <0x00 0xd520000 0x00 0x1000>;
	};

	dbg_apmcu_mp0@0d530000 {
		compatible = "mediatek,dbg_apmcu_mp0";
		reg = <0x00 0xd530000 0x00 0x1000>;
	};

	dbg_apmcu_mp0@0d540000 {
		compatible = "mediatek,dbg_apmcu_mp0";
		reg = <0x00 0xd540000 0x00 0x1000>;
	};

	dbg_apmcu_mp0@0d610000 {
		compatible = "mediatek,dbg_apmcu_mp0";
		reg = <0x00 0xd610000 0x00 0x1000>;
	};

	dbg_apmcu_mp0@0d620000 {
		compatible = "mediatek,dbg_apmcu_mp0";
		reg = <0x00 0xd620000 0x00 0x1000>;
	};

	dbg_apmcu_mp0@0d630000 {
		compatible = "mediatek,dbg_apmcu_mp0";
		reg = <0x00 0xd630000 0x00 0x1000>;
	};

	dbg_apmcu_mp0@0d640000 {
		compatible = "mediatek,dbg_apmcu_mp0";
		reg = <0x00 0xd640000 0x00 0x1000>;
	};

	dbg_apmcu_mp0@0d710000 {
		compatible = "mediatek,dbg_apmcu_mp0";
		reg = <0x00 0xd710000 0x00 0x1000>;
	};

	dbg_apmcu_mp0@0d720000 {
		compatible = "mediatek,dbg_apmcu_mp0";
		reg = <0x00 0xd720000 0x00 0x1000>;
	};

	dbg_apmcu_mp0@0d730000 {
		compatible = "mediatek,dbg_apmcu_mp0";
		reg = <0x00 0xd730000 0x00 0x1000>;
	};

	dbg_apmcu_mp0@0d740000 {
		compatible = "mediatek,dbg_apmcu_mp0";
		reg = <0x00 0xd740000 0x00 0x1000>;
	};

	dbg_apmcu_mp1@0d800000 {
		compatible = "mediatek,dbg_apmcu_mp1";
		reg = <0x00 0xd800000 0x00 0x1000>;
	};

	dbg_apmcu_mp1@0d810000 {
		compatible = "mediatek,dbg_apmcu_mp1";
		reg = <0x00 0xd810000 0x00 0x1000>;
	};

	dbg_apmcu_mp1@0d820000 {
		compatible = "mediatek,dbg_apmcu_mp1";
		reg = <0x00 0xd820000 0x00 0x1000>;
	};

	dbg_apmcu_mp1@0d830000 {
		compatible = "mediatek,dbg_apmcu_mp1";
		reg = <0x00 0xd830000 0x00 0x1000>;
	};

	dbg_apmcu_mp1@0d840000 {
		compatible = "mediatek,dbg_apmcu_mp1";
		reg = <0x00 0xd840000 0x00 0x1000>;
	};

	dbg_apmcu_mp1@0d910000 {
		compatible = "mediatek,dbg_apmcu_mp1";
		reg = <0x00 0xd910000 0x00 0x1000>;
	};

	dbg_apmcu_mp1@0d920000 {
		compatible = "mediatek,dbg_apmcu_mp1";
		reg = <0x00 0xd920000 0x00 0x1000>;
	};

	dbg_apmcu_mp1@0d930000 {
		compatible = "mediatek,dbg_apmcu_mp1";
		reg = <0x00 0xd930000 0x00 0x1000>;
	};

	dbg_apmcu_mp1@0d940000 {
		compatible = "mediatek,dbg_apmcu_mp1";
		reg = <0x00 0xd940000 0x00 0x1000>;
	};

	dbg_apmcu_mp1@0da10000 {
		compatible = "mediatek,dbg_apmcu_mp1";
		reg = <0x00 0xda10000 0x00 0x1000>;
	};

	dbg_apmcu_mp1@0da20000 {
		compatible = "mediatek,dbg_apmcu_mp1";
		reg = <0x00 0xda20000 0x00 0x1000>;
	};

	dbg_apmcu_mp1@0da30000 {
		compatible = "mediatek,dbg_apmcu_mp1";
		reg = <0x00 0xda30000 0x00 0x1000>;
	};

	dbg_apmcu_mp1@0da40000 {
		compatible = "mediatek,dbg_apmcu_mp1";
		reg = <0x00 0xda40000 0x00 0x1000>;
	};

	dbg_apmcu_mp1@0db10000 {
		compatible = "mediatek,dbg_apmcu_mp1";
		reg = <0x00 0xdb10000 0x00 0x1000>;
	};

	dbg_apmcu_mp1@0db20000 {
		compatible = "mediatek,dbg_apmcu_mp1";
		reg = <0x00 0xdb20000 0x00 0x1000>;
	};

	dbg_apmcu_mp1@0db30000 {
		compatible = "mediatek,dbg_apmcu_mp1";
		reg = <0x00 0xdb30000 0x00 0x1000>;
	};

	dbg_apmcu_mp1@0db40000 {
		compatible = "mediatek,dbg_apmcu_mp1";
		reg = <0x00 0xdb40000 0x00 0x1000>;
	};
};
