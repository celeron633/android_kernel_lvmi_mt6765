// SPDX-License-Identifier: GPL-2.0-only
/* S17 Pro mini symbols configuration; included by s17promini.dtsi. */

/ {
	__symbols__ {
		camera_pins_default = "/pinctrl@1000b000/camdefault";
		camera_pins_cam_ldo_rear2_vcama_1 = "/pinctrl@1000b000/cam2@vcama1";
		camera_pins_cam_ldo_rear2_vcama_0 = "/pinctrl@1000b000/cam2@vcama0";
		camera_pins_cam_ldo_sub_vcama_1 = "/pinctrl@1000b000/cam1@vcama1";
		camera_pins_cam_ldo_sub_vcama_0 = "/pinctrl@1000b000/cam1@vcama0";
		camera_pins_cam_ldo_sub_vcamd_1 = "/pinctrl@1000b000/cam1@vcamd1";
		camera_pins_cam_ldo_sub_vcamd_0 = "/pinctrl@1000b000/cam1@vcamd0";
		camera_pins_cam_ldo_rear_vcamd_1 = "/pinctrl@1000b000/cam0@vcamd1";
		camera_pins_cam_ldo_rear_vcamd_0 = "/pinctrl@1000b000/cam0@vcamd0";
		camera_pins_cam2_pnd1 = "/pinctrl@1000b000/cam2@3";
		camera_pins_cam2_pnd0 = "/pinctrl@1000b000/cam2@2";
		camera_pins_cam2_rst1 = "/pinctrl@1000b000/cam2@1";
		camera_pins_cam2_rst0 = "/pinctrl@1000b000/cam2@0";
		camera_pins_cam1_pnd1 = "/pinctrl@1000b000/cam1@3";
		camera_pins_cam1_pnd0 = "/pinctrl@1000b000/cam1@2";
		camera_pins_cam1_rst1 = "/pinctrl@1000b000/cam1@1";
		camera_pins_cam1_rst0 = "/pinctrl@1000b000/cam1@0";
		camera_pins_cam0_pnd1 = "/pinctrl@1000b000/cam0@3";
		camera_pins_cam0_pnd0 = "/pinctrl@1000b000/cam0@2";
		camera_pins_cam0_rst1 = "/pinctrl@1000b000/cam0@1";
		camera_pins_cam0_rst0 = "/pinctrl@1000b000/cam0@0";
		camera_pins_cam2_mclk_off = "/pinctrl@1000b000/camera_pins_cam2_mclk_off";
		camera_pins_cam2_mclk_on = "/pinctrl@1000b000/camera_pins_cam2_mclk_on";
		camera_pins_cam1_mclk_off = "/pinctrl@1000b000/camera_pins_cam1_mclk_off";
		camera_pins_cam1_mclk_on = "/pinctrl@1000b000/camera_pins_cam1_mclk_on";
		camera_pins_cam0_mclk_off = "/pinctrl@1000b000/camera_pins_cam0_mclk_off";
		camera_pins_cam0_mclk_on = "/pinctrl@1000b000/camera_pins_cam0_mclk_on";
		ext_buck_vgpu_mtk = "/i2c6@1100d000/ext_buck_vgpu@55";
		camera_main_two_af_mtk = "/i2c6@1100d000/camera_main_two_af@0c";
		camera_main_two_eeprom_mtk = "/i2c6@1100d000/camera_main_two_eeprom@50";
		camera_main_two_mtk = "/i2c6@1100d000/camera_main_two@2d";
		usb_type_c_mtk = "/i2c5@11016000/usb_type_c@4e";
		subpmic_pmu_mtk = "/i2c5@11016000/subpmic_pmu@34";
		ccu_sensor_i2c_4_hw_mtk = "/i2c4@11011000/ccu_sensor_i2c_4_hw@11";
		camera_sub_eeprom_mtk = "/i2c4@11011000/camera_sub_eeprom@52";
		camera_sub_mtk = "/i2c4@11011000/camera_sub@2d";
		ext_buck_lp4x_mtk = "/i2c3@1100f000/ext_buck_lp4x@50";
		ext_buck_lp4_mtk = "/i2c3@1100f000/ext_buck_lp4@57";
		nfc_mtk = "/i2c3@1100f000/nfc@08";
		slave_charger_mtk = "/i2c3@1100f000/slave_charger@4b";
		speaker_amp_mtk = "/i2c3@1100f000/speaker_amp@34";
		ccu_sensor_i2c_2_hw_mtk = "/i2c2@11009000/ccu_sensor_i2c_2_hw@10";
		camera_main_af_mtk = "/i2c2@11009000/camera_main_af@0c";
		camera_main_eeprom_mtk = "/i2c2@11009000/camera_main_eeprom@50";
		camera_main_mtk = "/i2c2@11009000/camera_main@1a";
		flashlights_gpio_high = "/pinctrl@1000b000/output1";
		flashlights_gpio_low = "/pinctrl@1000b000/output0";
		AUD_pins_extamp1 = "/pinctrl@1000b000/extamp@1";
		AUD_pins_extamp0 = "/pinctrl@1000b000/extamp@0";
		aud_pins_smartpa_on = "/pinctrl@1000b000/aud_pins_smartpa_on";
		aud_pins_smartpa_off = "/pinctrl@1000b000/aud_pins_smartpa_off";
		aud_dat_miso_on = "/pinctrl@1000b000/aud_dat_miso_on";
		aud_dat_miso_off = "/pinctrl@1000b000/aud_dat_miso_off";
		aud_dat_mosi_on = "/pinctrl@1000b000/aud_dat_mosi_on";
		aud_dat_mosi_off = "/pinctrl@1000b000/aud_dat_mosi_off";
		aud_clk_miso_on = "/pinctrl@1000b000/aud_clk_miso_on";
		aud_clk_miso_off = "/pinctrl@1000b000/aud_clk_miso_off";
		aud_clk_mosi_on = "/pinctrl@1000b000/aud_clk_mosi_on";
		aud_clk_mosi_off = "/pinctrl@1000b000/aud_clk_mosi_off";
		irtx_gpio_led_set = "/pinctrl@1000b000/irtx_gpio_led_set@gpio90";
		irtx_gpio_led_default = "/pinctrl@1000b000/irtx_gpio_led_def@gpio90";
		fingerprint_reset_low = "/pinctrl@1000b000/state_reset_low";
		fingerprint_reset_high = "/pinctrl@1000b000/state_reset_high";
		fingerprint_default = "/pinctrl@1000b000/state_default";
		accdet_pinst_as_switch_low = "/pinctrl@1000b000/accdetswitch_low";
		accdet_pinst_as_switch_high = "/pinctrl@1000b000/accdetswitch_high";
		accdet_pins_eint_as_int = "/pinctrl@1000b000/accdeteint@0";
		accdet_pins_default = "/pinctrl@1000b000/accdetdefault";
		kpd_pins_default = "/pinctrl@1000b000/kpdgpiodefault";
		gpslna_pins_ol = "/pinctrl@1000b000/gpslna@2";
		gpslna_pins_oh = "/pinctrl@1000b000/gpslna@1";
		gpslna_pins_init = "/pinctrl@1000b000/gpslna@0";
		consys_pins_default = "/pinctrl@1000b000/consys_default";
		ctp_pins_rst_output1 = "/pinctrl@1000b000/rstoutput1";
		ctp_pins_rst_output0 = "/pinctrl@1000b000/rstoutput0";
		ctp_pins_eint_output1 = "/pinctrl@1000b000/eintoutput1";
		ctp_pins_eint_output0 = "/pinctrl@1000b000/eintoutput0";
		ctp_pins_eint_as_int = "/pinctrl@1000b000/eint@0";
		ctp_pins_default = "/pinctrl@1000b000/eint0default";
		mtkfb_pins_default = "/pinctrl@1000b000/dispdefault";
		mtkfb_pins_lcd_bias_enn1 = "/pinctrl@1000b000/lcd_bias_enn1_gpio";
		mtkfb_pins_lcd_bias_enn0 = "/pinctrl@1000b000/lcd_bias_enn0_gpio";
		mtkfb_pins_lcd_bias_enp1 = "/pinctrl@1000b000/lcd_bias_enp1_gpio";
		mtkfb_pins_lcd_bias_enp0 = "/pinctrl@1000b000/lcd_bias_enp0_gpio";
		mtkfb_pins_lcm_reset1 = "/pinctrl@1000b000/lcm_rst_out1_gpio";
		mtkfb_pins_lcm_reset0 = "/pinctrl@1000b000/lcm_rst_out0_gpio";
		usb_typec_will = "/i2c1@11008000/wusb3801@60";
		vibrator0 = "/odm/vibrator@0";
		led6 = "/odm/led@6";
		led5 = "/odm/led@5";
		led4 = "/odm/led@4";
		led3 = "/odm/led@3";
		led2 = "/odm/led@2";
		led1 = "/odm/led@1";
		led0 = "/odm/led@0";
		chosen = "/chosen";
		regulator_vibrator = "/regulator_vibrator";
		cluster0_opp = "/opp_table0";
		cluster1_opp = "/opp_table1";
		cci_opp = "/opp_table2";
		cci = "/cci";
		cpu0 = "/cpus/cpu@000";
		cpu1 = "/cpus/cpu@001";
		cpu2 = "/cpus/cpu@002";
		cpu3 = "/cpus/cpu@003";
		cpu4 = "/cpus/cpu@100";
		cpu5 = "/cpus/cpu@101";
		cpu6 = "/cpus/cpu@102";
		cpu7 = "/cpus/cpu@103";
		STANDBY = "/cpus/idle-states/standby";
		MCDI_CPU = "/cpus/idle-states/mcdi-cpu";
		MCDI_CLUSTER = "/cpus/idle-states/mcdi-cluster";
		SODI = "/cpus/idle-states/sodi";
		SODI3 = "/cpus/idle-states/sodi3";
		DPIDLE = "/cpus/idle-states/dpidle";
		SUSPEND = "/cpus/idle-states/suspend";
		reserved_memory = "/reserved-memory";
		consys_mem = "/reserved-memory/consys-reserve-memory";
		wifi_mem = "/reserved-memory/wifi-reserve-memory";
		ssmr_cma_mem = "/reserved-memory/ssmr-reserved-cma_memory";
		cpu_dbgapb = "/cpu_dbgapb@0d410000";
		gic = "/interrupt-controller@0c000000";
		dcm = "/dcm@10001000";
		sysirq = "/intpol-controller@10200a80";
		infracfg_ao = "/infracfg_ao@10001000";
		scpsys = "/scpsys@10001000";
		topckgen = "/topckgen@10000000";
		scp_infra = "/scp_infra@10001000";
		io_cfg_lt = "/io_cfg_lt@10002000";
		io_cfg_lm = "/io_cfg_lm@10002200";
		io_cfg_lb = "/io_cfg_lb@10002400";
		io_cfg_bl = "/io_cfg_bl@10002600";
		io_cfg_rr = "/io_cfg_rr@10002800";
		io_cfg_rb = "/io_cfg_rb@10002a00";
		io_cfg_rt = "/io_cfg_rt@10002c00";
		pericfg = "/pericfg@10003000";
		gpio_usage_mapping = "/gpio";
		eint = "/eint@1000b000";
		gpio = "/gpio@10005000";
		pio = "/pinctrl@1000b000";
		msdc0_pins_default = "/pinctrl@1000b000/msdc0@default";
		msdc0_pins_hs400 = "/pinctrl@1000b000/msdc0@hs400";
		msdc0_pins_hs200 = "/pinctrl@1000b000/msdc0@hs200";
		msdc0_register_setting_default = "/pinctrl@1000b000/msdc0@register_default";
		msdc1_pins_default = "/pinctrl@1000b000/msdc1@default";
		msdc1_pins_sdr104 = "/pinctrl@1000b000/msdc1@sdr104";
		msdc1_pins_sdr50 = "/pinctrl@1000b000/msdc1@sdr50";
		msdc1_pins_ddr50 = "/pinctrl@1000b000/msdc1@ddr50";
		msdc1_register_setting_default = "/pinctrl@1000b000/msdc1@register_default";
		msdc3_pins_default = "/pinctrl@1000b000/msdc3@default";
		msdc3_register_setting_default = "/pinctrl@1000b000/msdc3@register_default";
		sleep = "/sleep@10006000";
		toprgu = "/toprgu@10007000";
		hwrng = "/hwrng";
		clk26m = "/clocks/clk26m";
		clk13m = "/clocks/clk13m";
		clk32k = "/clocks/clk32k";
		apmixed = "/apmixed@1000c000";
		pwrap = "/pwrap@1000d000";
		main_pmic = "/pwrap@1000d000/main_pmic";
		pmic_accdet = "/pwrap@1000d000/main_pmic/pmic_accdet";
		mt6357keys = "/pwrap@1000d000/main_pmic/mt6357keys";
		pmic_auxadc = "/pwrap@1000d000/main_pmic/pmic_auxadc";
		mtk_gauge = "/pwrap@1000d000/main_pmic/mtk_gauge";
		mtk_charger_type = "/pwrap@1000d000/main_pmic/mtk_charger_type";
		mt6357_charger = "/pwrap@1000d000/main_pmic/mt6357_charger";
		mtk_ts_pmic = "/pwrap@1000d000/main_pmic/mtk_ts_pmic";
		mt6357_ts_buck1 = "/pwrap@1000d000/main_pmic/mt6357_ts_buck1";
		mt6357_ts_buck2 = "/pwrap@1000d000/main_pmic/mt6357_ts_buck2";
		pmic_efuse = "/pwrap@1000d000/main_pmic/pmic_efuse";
		mt6357regulator = "/pwrap@1000d000/main_pmic/mt6357regulator";
		mt_pmic_vs1_buck_reg = "/pwrap@1000d000/main_pmic/mt6357regulator/buck_vs1";
		mt_pmic_vmodem_buck_reg = "/pwrap@1000d000/main_pmic/mt6357regulator/buck_vmodem";
		mt_pmic_vcore_buck_reg = "/pwrap@1000d000/main_pmic/mt6357regulator/buck_vcore";
		mt_pmic_vproc_buck_reg = "/pwrap@1000d000/main_pmic/mt6357regulator/buck_vproc";
		mt_pmic_vpa_buck_reg = "/pwrap@1000d000/main_pmic/mt6357regulator/buck_vpa";
		mt_pmic_vfe28_ldo_reg = "/pwrap@1000d000/main_pmic/mt6357regulator/ldo_vfe28";
		mt_pmic_vxo22_ldo_reg = "/pwrap@1000d000/main_pmic/mt6357regulator/ldo_vxo22";
		mt_pmic_vrf18_ldo_reg = "/pwrap@1000d000/main_pmic/mt6357regulator/ldo_vrf18";
		mt_pmic_vrf12_ldo_reg = "/pwrap@1000d000/main_pmic/mt6357regulator/ldo_vrf12";
		mt_pmic_vefuse_ldo_reg = "/pwrap@1000d000/main_pmic/mt6357regulator/ldo_vefuse";
		mt_pmic_vcn33_bt_ldo_reg = "/pwrap@1000d000/main_pmic/mt6357regulator/ldo_vcn33_bt";
		mt_pmic_vcn33_wifi_ldo_reg = "/pwrap@1000d000/main_pmic/mt6357regulator/ldo_vcn33_wifi";
		mt_pmic_vcn28_ldo_reg = "/pwrap@1000d000/main_pmic/mt6357regulator/ldo_vcn28";
		mt_pmic_vcn18_ldo_reg = "/pwrap@1000d000/main_pmic/mt6357regulator/ldo_vcn18";
		mt_pmic_vcama_ldo_reg = "/pwrap@1000d000/main_pmic/mt6357regulator/ldo_vcama";
		mt_pmic_vcamd_ldo_reg = "/pwrap@1000d000/main_pmic/mt6357regulator/ldo_vcamd";
		mt_pmic_vcamio_ldo_reg = "/pwrap@1000d000/main_pmic/mt6357regulator/ldo_vcamio";
		mt_pmic_vldo28_ldo_reg = "/pwrap@1000d000/main_pmic/mt6357regulator/ldo_vldo28";
		mt_pmic_vsram_others_ldo_reg = "/pwrap@1000d000/main_pmic/mt6357regulator/ldo_vsram_others";
		mt_pmic_vsram_proc_ldo_reg = "/pwrap@1000d000/main_pmic/mt6357regulator/ldo_vsram_proc";
		mt_pmic_vaux18_ldo_reg = "/pwrap@1000d000/main_pmic/mt6357regulator/ldo_vaux18";
		mt_pmic_vaud28_ldo_reg = "/pwrap@1000d000/main_pmic/mt6357regulator/ldo_vaud28";
		mt_pmic_vio28_ldo_reg = "/pwrap@1000d000/main_pmic/mt6357regulator/ldo_vio28";
		mt_pmic_vio18_ldo_reg = "/pwrap@1000d000/main_pmic/mt6357regulator/ldo_vio18";
		mt_pmic_vdram_ldo_reg = "/pwrap@1000d000/main_pmic/mt6357regulator/ldo_vdram";
		mt_pmic_vmc_ldo_reg = "/pwrap@1000d000/main_pmic/mt6357regulator/ldo_vmc";
		mt_pmic_vmch_ldo_reg = "/pwrap@1000d000/main_pmic/mt6357regulator/ldo_vmch";
		mt_pmic_vemc_ldo_reg = "/pwrap@1000d000/main_pmic/mt6357regulator/ldo_vemc";
		mt_pmic_vsim1_ldo_reg = "/pwrap@1000d000/main_pmic/mt6357regulator/ldo_vsim1";
		mt_pmic_vsim2_ldo_reg = "/pwrap@1000d000/main_pmic/mt6357regulator/ldo_vsim2";
		mt_pmic_vibr_ldo_reg = "/pwrap@1000d000/main_pmic/mt6357regulator/ldo_vibr";
		mt_pmic_vusb33_ldo_reg = "/pwrap@1000d000/main_pmic/mt6357regulator/ldo_vusb33";
		mtk_rtc = "/pwrap@1000d000/main_pmic/mtk_rtc";
		fg_init = "/pwrap@1000d000/main_pmic/mtk_rtc/fg_init";
		fg_soc = "/pwrap@1000d000/main_pmic/mtk_rtc/fg_soc";
		ext_32k = "/pwrap@1000d000/main_pmic/mtk_rtc/ext_32k";
		pmic_codec = "/pwrap@1000d000/main_pmic/pmic_codec";
		clock_buffer_ctrl = "/pwrap@1000d000/main_pmic/clock_buffer_ctrl";
		keypad = "/kp@10010000";
		otg_iddig = "/otg_iddig";
		mrdump_ext_rst = "/mrdump_ext_rst";
		touch = "/touch";
		accdet = "/accdet";
		goodix_fp = "/fingerprint";
		microarray_finger = "/microarray_finger";
		silead_spi = "/silead_spi@";
		silead_fp = "/silead_fp@";
		writing = "/writing";
		dvfsrc = "/dvfsrc@10012000";
		dvfsrc_freq_opp2 = "/dvfsrc@10012000/opp2";
		dvfsrc_freq_opp1 = "/dvfsrc@10012000/opp1";
		dvfsrc_freq_opp0 = "/dvfsrc@10012000/opp0";
		timer = "/timer@10017000";
		ccifdriver = "/ccifdriver@10209000";
		cldmadriver = "/cldmadriver@10014000";
		mddriver = "/mddriver@10014000";
		md_auxadc = "/md_auxadc";
		gce = "/gce@10238000";
		gce_mbox = "/gce_mbox@10238000";
		gce_mbox_svp = "/gce_mbox_svp@10238000";
		auxadc = "/auxadc@11001000";
		apdma = "/dma-controller@11000580";
		uart0 = "/serial@11020000";
		uart1 = "/serial@11030000";
		i2c_common = "/i2c_common";
		i2c0 = "/i2c0@11007000";
		i2c1 = "/i2c1@11008000";
		i2c2 = "/i2c2@11009000";
		i2c3 = "/i2c3@1100f000";
		i2c4 = "/i2c4@11011000";
		i2c5 = "/i2c5@11016000";
		i2c6 = "/i2c6@1100d000";
		pwm = "/pwm@11006000";
		spi0 = "/spi@1100a000";
		tboard_thermistor1 = "/thermal-sensor1";
		tboard_thermistor2 = "/thermal-sensor2";
		tboard_thermistor3 = "/thermal-sensor3";
		auxadc2_lcm = "/auxadc2_lcm";
		consys = "/consys@18002000";
		wifi = "/wifi@18000000";
		spi1 = "/spi@11010000";
		spi2 = "/spi@11012000";
		spi3 = "/spi@11013000";
		spi4 = "/spi@11014000";
		spi5 = "/spi@11015000";
		usb = "/usb0@11200000";
		u2phy0 = "/usb-phy@11210000";
		u2port0 = "/usb-phy@11210000/usb-phy@11210000";
		msdc0 = "/msdc@11230000";
		msdc1 = "/msdc@11240000";
		msdc2 = "/msdc@11250000";
		msdc3 = "/msdc@11260000";
		msdc1_ins = "/msdc1_ins@0";
		audclk = "/audclk@11220000";
		audio = "/audio@11220000";
		audgpio = "/mt_soc_dl1_pcm@11220000";
		btcvsd_snd = "/mtk-btcvsd-snd@18050000";
		mipi_rx_ana_csi0a = "/mipi_rx_ana_csi0a@11c10000";
		mipi_rx_ana_csi0b = "/mipi_rx_ana_csi0b@11c11000";
		mipi_rx_ana_csi1a = "/mipi_rx_ana_csi1a@11c12000";
		mipi_rx_ana_csi1b = "/mipi_rx_ana_csi1b@11c13000";
		mipi_rx_ana_csi2a = "/mipi_rx_ana_csi2a@11c14000";
		mipi_rx_ana_csi2b = "/mipi_rx_ana_csi2b@11c15000";
		efuse = "/efuse@11c50000";
		efuse_segment = "/efuse@11c50000/segment@78";
		cpu_freq_segment = "/efuse@11c50000/segment@1c";
		thermal_efuse = "/efuse@11c50000/segment@190";
		efuse_ly = "/efuse@11c50000/ly@210";
		u2_phy_data = "/efuse@11c50000/u2_phy_data@1ac";
		mfg_doma = "/mfg_doma@13000000";
		mfg_cfg = "/mfg_cfg@13ffe000";
		gpufreq = "/gpufreq";
		ged = "/ged";
		mmsys_config = "/mmsys_config@14000000";
		dispsys_config = "/dispsys_config@14000000";
		nfc = "/nfc";
		irq_nfc = "/irq_nfc";
		mtee_svp = "/mtee_svp";
		disp_mutex0 = "/disp_mutex0@14001000";
		smi_common = "/smi_common@14002000";
		imgsys = "/imgsys_clk@15020000";
		smi_larb0 = "/smi_larb0@14003000";
		mdp_rdma0 = "/mdp_rdma0@14004000";
		mdp_ccorr = "/mdp_ccorr0@14005000";
		mdp_rsz0 = "/mdp_rsz0@14006000";
		mdp_rsz1 = "/mdp_rsz1@14007000";
		mdp_wdma0 = "/mdp_wdma0@14008000";
		mdp_wrot0 = "/mdp_wrot0@14009000";
		mdp_tdshp0 = "/mdp_tdshp0@1400a000";
		disp_color0 = "/disp_color0@1400f000";
		mtkfb = "/mtkfb@0";
		dsi_te = "/dsi_te";
		smi_larb2 = "/smi_larb2@15021000";
		vcodecsys = "/vcodecsys@17000000";
		venc_gcon = "/venc_gcon@17000000";
		smi_larb1 = "/smi_larb1@17010000";
		camsys = "/camsys@1a000000";
		camsys1 = "/camsysisp@1a000000";
		smi_larb3 = "/smi_larb3@1a002000";
		kd_camera_hw1 = "/kd_camera_hw1@1a040000";
		camera_af_hw_node = "/camera_af_hw_node";
		flashlight_core = "/flashlight_core";
		flashlights_mt6370 = "/flashlights_mt6370";
		flashlights_isink = "/flashlights_isink";
		flashlights_dummy_gpio = "/flashlights_dummy_gpio";
		fm = "/fmradio";
		gyro = "/gyro";
		als = "/als_ps@0";
		lk_charger = "/lk_charger";
		pe = "/pe";
		pe2 = "/pe2";
		pdc = "/pdc";
		pe4 = "/pe4";
		charger = "/charger";
		pd_adapter = "/pd_adapter";
		extcon_usb = "/extcon_usb";
		rt9465_slave_chr = "/rt9465_slave_chr";
		subpmic_pmu_eint = "/mt6370_pmu_eint";
		tcpc_pd = "/mt6370_pd_eint";
		irtx_pwm = "/irtx_pwm";
		odm = "/odm";
		memory_ssmr_features = "/memory-ssmr-features";
		radio_md_cfg = "/radio_md_cfg";
		dynamic_options = "/dynamic_options";
		pmic_clock_buffer_ctrl = "/pmic_clock_buffer_ctrl";
		i2c7 = "/i2c7";
		i2c8 = "/i2c8";
		i2c9 = "/i2c9";
		smart_pa = "/smart_pa";
		md1_sim1_hot_plug_eint = "/md1_sim1_hot_plug_eint";
		md1_sim2_hot_plug_eint = "/md1_sim2_hot_plug_eint";
		cm_mgr = "/cm_mgr@10200000";
		mt6370_pmu = "/mt6370_pmu_dts";
		mt6370_chg = "/mt6370_pmu_dts/charger";
		otg_vbus = "/mt6370_pmu_dts/charger/usb-otg-vbus";
		mt6370_typec = "/type_c_port0";
	};
};
